#include "codec_es8389.h"

/*
 * ATTENTION: The functions are defined in the file driver_iic_soft.c, 
 *            the param iic_addr in which is 7bits i2c address !
 */
static uint8_t g_es8389_addr = 0x0;
static const struct _coeff_div coeff_div[] = {
    //	Ratio	Freq MCLK	FreqLRCK,Reg0x04,Reg0x05,Reg0x06,Reg0x07,Reg0x08,Reg0x09,Reg0x0A,Reg0x0F,Reg0x11,Reg0x21,Reg0x22,Reg0x26,Reg0x30,Reg0x41,Reg0x42,Reg0x43,Reg0xF0,Reg0xF1,Reg0x16,Reg0x18,Reg0x19
    {32, 256000, 8000, 0x00, 0x57, 0x84, 0xD0, 0x03, 0xC1, 0xB0, 0x00, 0x00, 0x1F, 0x7F, 0xBF, 0xC0, 0xFF, 0x7F, 0x01, 0x12, 0x00, 0x09, 0x19, 0x07},
    {36, 288000, 8000, 0x00, 0x55, 0x84, 0xD0, 0x01, 0xC1, 0x90, 0x00, 0x00, 0x23, 0x8F, 0xB7, 0xC0, 0x1F, 0x8F, 0x01, 0x12, 0x00, 0x09, 0x19, 0x07},
    {48, 384000, 8000, 0x02, 0x5F, 0x04, 0xC0, 0x03, 0xC1, 0xB0, 0x00, 0x00, 0x1F, 0x7F, 0xBF, 0xC0, 0xFF, 0x7F, 0x01, 0x12, 0x00, 0x09, 0x19, 0x07},
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    {288, 2304000, 8000, 0x01, 0x51, 0x00, 0xC0, 0x01, 0xC1, 0x90, 0x00, 0x00, 0x23, 0x8F, 0xB7, 0xC0, 0x1F, 0x8F, 0x01, 0x12, 0x00, 0x09, 0x19, 0x07},
    // 10
    {384, 3072000, 8000, 0x02, 0x45, 0x04, 0xD0, 0x03, 0xC1, 0xB0, 0x00, 0x00, 0x1F, 0x7F, 0xBF, 0xC0, 0xFF, 0x7F, 0x01, 0x12, 0x00, 0x09, 0x19, 0x07},
    {512, 4096000, 8000, 0x00, 0x41, 0x04, 0xE0, 0x00, 0xD1, 0xB0, 0x00, 0x00, 0x1F, 0x7F, 0xBF, 0xC0, 0xFF, 0x7F, 0x01, 0x12, 0x00, 0x09, 0x19, 0x07},
    {768, 6144000, 8000, 0x05, 0x45, 0x04, 0xD0, 0x03, 0xC1, 0xB0, 0x00, 0x00, 0x1F, 0x7F, 0xBF, 0xC0, 0xFF, 0x7F, 0x01, 0x12, 0x00, 0x09, 0x19, 0x07},
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    {32, 512000, 16000, 0x00, 0x55, 0x84, 0xD0, 0x01, 0xC1, 0x90, 0x00, 0x00, 0x1F, 0x7F, 0xBF, 0xC0, 0xFF, 0x7F, 0x00, 0x12, 0x00, 0x12, 0x31, 0x0E},
    // 20
    {36, 576000, 16000, 0x00, 0x55, 0x84, 0xD0, 0x01, 0xC1, 0x90, 0x00, 0x00, 0x23, 0x8F, 0xB7, 0xC0, 0x1F, 0x8F, 0x01, 0x12, 0x00, 0x12, 0x31, 0x0E},
    {48, 768000, 16000, 0x02, 0x57, 0x04, 0xC0, 0x01, 0xC1, 0x90, 0x00, 0x00, 0x1F, 0x7F, 0xBF, 0xC0, 0xFF, 0x7F, 0x00, 0x12, 0x00, 0x12, 0x31, 0x0E},
    {50, 800000, 16000, 0x00, 0x7E, 0x01, 0xD9, 0x00, 0xC2, 0x80, 0x00, 0x00, 0x18, 0x95, 0xD0, 0xC0, 0xC7, 0x95, 0x00, 0x12, 0x00, 0x12, 0x31, 0x0E},
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    {256, 4096000, 16000, 0x00, 0x41, 0x04, 0xC0, 0x01, 0xD1, 0x90, 0x00, 0x00, 0x1F, 0x7F, 0xBF, 0xC0, 0xFF, 0x7F, 0x00, 0x12, 0x00, 0x12, 0x31, 0x0E},
    // 30
    {300, 4800000, 16000, 0x02, 0x66, 0x01, 0xD9, 0x00, 0xC2, 0x80, 0x00, 0x00, 0x18, 0x95, 0xD0, 0xC0, 0xC7, 0x95, 0x00, 0x12, 0x00, 0x12, 0x31, 0x0E},
    {384, 6144000, 16000, 0x02, 0x51, 0x04, 0xD0, 0x01, 0xC1, 0x90, 0x00, 0x00, 0x1F, 0x7F, 0xBF, 0xC0, 0xFF, 0x7F, 0x00, 0x12, 0x00, 0x12, 0x31, 0x0E},
    {512, 8192000, 16000, 0x01, 0x41, 0x04, 0xC0, 0x01, 0xD1, 0x90, 0x00, 0x00, 0x1F, 0x7F, 0xBF, 0xC0, 0xFF, 0x7F, 0x00, 0x12, 0x00, 0x12, 0x31, 0x0E},
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    {1536, 24576000, 16000, 0x05, 0x41, 0x04, 0xC0, 0x01, 0xD1, 0x90, 0xC0, 0x00, 0x1F, 0x7F, 0xBF, 0xC0, 0xFF, 0x7F, 0x00, 0x12, 0x00, 0x12, 0x31, 0x0E},
    // 40
    {1625, 26000000, 16000, 0x40, 0x6E, 0x05, 0xC8, 0x01, 0xC2, 0x90, 0xC0, 0x00, 0x18, 0x95, 0xD0, 0xC0, 0x63, 0x95, 0x00, 0x12, 0x00, 0x12, 0x31, 0x0E},
    {800, 19200000, 24000, 0x07, 0x66, 0x01, 0xD9, 0x00, 0xC2, 0x80, 0x40, 0x00, 0x18, 0x95, 0xD0, 0xC0, 0xC7, 0x95, 0x00, 0x12, 0x00, 0x1A, 0x49, 0x14},
    {600, 19200000, 32000, 0x05, 0x46, 0x01, 0xD8, 0x10, 0xD2, 0x80, 0x40, 0x00, 0x18, 0x95, 0xD0, 0xC0, 0x63, 0x95, 0x00, 0x12, 0x00, 0x23, 0x61, 0x1B},
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    {48, 2304000, 48000, 0x02, 0x55, 0x04, 0xC0, 0x10, 0xC1, 0x80, 0x00, 0x00, 0x1F, 0x7F, 0xBF, 0xC0, 0x7F, 0x7F, 0x00, 0x12, 0x00, 0x35, 0x91, 0x28},
    // 50
    {50, 2400000, 48000, 0x00, 0x76, 0x01, 0xC8, 0x10, 0xC2, 0x80, 0x00, 0x00, 0x18, 0x95, 0xD0, 0xC0, 0x63, 0x95, 0x00, 0x12, 0x00, 0x35, 0x91, 0x28},
    {64, 3072000, 48000, 0x00, 0x51, 0x04, 0xC0, 0x10, 0xC1, 0x80, 0x00, 0x00, 0x1F, 0x7F, 0xBF, 0xC0, 0x7F, 0x7F, 0x00, 0x12, 0x00, 0x35, 0x91, 0x28},
    {100, 4800000, 48000, 0x00, 0x46, 0x01, 0xD8, 0x10, 0xD2, 0x80, 0x00, 0x00, 0x18, 0x95, 0xD0, 0xC0, 0x63, 0x95, 0x00, 0x12, 0x00, 0x35, 0x91, 0x28},
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    {400, 19200000, 48000, 0x03, 0x46, 0x01, 0xD8, 0x10, 0xD2, 0x80, 0x40, 0x00, 0x18, 0x95, 0xD0, 0xC0, 0x63, 0x95, 0x00, 0x12, 0x00, 0x35, 0x91, 0x28},
    // 60
    {500, 24000000, 48000, 0x04, 0x46, 0x01, 0xD8, 0x10, 0xD2, 0x80, 0xC0, 0x00, 0x18, 0x95, 0xD0, 0xC0, 0x63, 0x95, 0x00, 0x12, 0x00, 0x35, 0x91, 0x28},
    {512, 24576000, 48000, 0x03, 0x41, 0x04, 0xD0, 0x10, 0xD1, 0x80, 0xC0, 0x00, 0x1F, 0x7F, 0xBF, 0xC0, 0x7F, 0x7F, 0x00, 0x12, 0x00, 0x35, 0x91, 0x28},
    {800, 38400000, 48000, 0x18, 0x45, 0x04, 0xC0, 0x10, 0xC1, 0x80, 0xC0, 0x00, 0x1F, 0x7F, 0xBF, 0xC0, 0x7F, 0x7F, 0x00, 0x12, 0x00, 0x35, 0x91, 0x28},
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    {1500, 12000000, 8000, 0x0E, 0x25, 0x25, 0xE8, 0x00, 0xD1, 0x90, 0x40, 0x00, 0x31, 0xC7, 0xC5, 0x00, 0x8F, 0xC7, 0x01, 0x12, 0x00, 0x09, 0x19, 0x07},
    // 70
    {2400, 19200000, 8000, 0x0B, 0x01, 0x00, 0xD0, 0x00, 0xD1, 0x80, 0x90, 0x00, 0x31, 0xC7, 0xC5, 0x00, 0xC7, 0xC7, 0x00, 0x12, 0x00, 0x09, 0x19, 0x07},
    {3000, 24000000, 8000, 0x0E, 0x24, 0x05, 0xD0, 0x00, 0xC2, 0x80, 0xC0, 0x00, 0x31, 0xC7, 0xC5, 0x00, 0x8F, 0xC7, 0x01, 0x12, 0x00, 0x09, 0x19, 0x07},
    {3250, 26000000, 8000, 0x40, 0x05, 0xA4, 0xC0, 0x00, 0xD1, 0x80, 0xD0, 0x00, 0x31, 0xC7, 0xC5, 0x00, 0xC7, 0xC7, 0x00, 0x12, 0x00, 0x09, 0x19, 0x07},
};

static user_es8389_info_t es_info;

/*
 * Referred volume level.
 * As for 5W speaker, the max. volume value is 0xB8.
 * As for 10W speaker, the max. volume value is 0xBE.
 */
#if 0
static const uint8_t codec_vol_16[16] = 
{
    /* 0  静音 */
    0,

    /* 1~3  强制出声区（很关键） 64, 96, 128 */
    0x40, 0x60, 0x80,

    /* 4~8  正常使用区 152, 176, 191, 203, 212 */
    0x98, 0xB0, 0xBF, 0xCB, 0xD4,

    /* 9~12  明显偏大 224, 234, 242, 248 */
    0xE0, 0xEA, 0xF2, 0xF8,

    /* 13~15  最大音量 252, 254, 255*/
    0xFC, 0xFE, 0xFF
};
#endif

//#define USING_SPK_10W
#define USING_SPK_5W
/* 
 * 经过优化后的 16 级音量表：level 0~15 → ES8389 音量 0~255 
 * As for 5W speaker, the max. volume value is 0xB8.
 * As for 10W speaker, the max. volume value is 0xBE.
 *
 * By chuzewei on 2026/03/24
 */
#ifdef USING_SPK_10W
const uint8_t es8389_vol_lut_16[16] = {
    /* 0, Mute */
    0x00,
    /* 1 ~ 6, Forced sound zone (critical) */
    /* 0x34, 0x4C, 0x5E, 0x6D, 0x79, 0x84, */
    /* 0x5E, 0x67, 0x6F, 0x78, 0x80, 0x88, */
    0x5E, 0x63, 0x67, 0x78, 0x85, 0x8D, 
    /* 7 ~ 15, Normal sound zone */
    /* 0x8E, 0x97, 0xA0, 0xA7, 0xAE, 0xB3, 0xB8, 0xBC, 0xBE */
    0x95, 0x9C, 0x9F, 0xA1, 0xA4, 0xA9, 0xAF, 0xB6, 0xBE
};
#elif defined(USING_SPK_5W)
const uint8_t es8389_vol_lut_16[16] = {
    /* 0, Mute */
    0x00,
    /* 1 ~ 6, Forced sound zone (critical) */
    /* 0x34, 0x4C, 0x5E, 0x6D, 0x79, 0x84, */
    /* 0x5E, 0x67, 0x6F, 0x78, 0x7E, 0x85, */
    0x5E, 0x63, 0x67, 0x78, 0x85, 0x8D, 
    /* 7 ~ 15, Normal sound zone */
    /* 0x8A, 0x90, 0x97, 0x9C, 0xA2, 0xA9, 0xB0, 0xB4, 0xB8 */
    0x95, 0x9C, 0x9F, 0xA1, 0xA4, 0xA7, 0xAC, 0xB2, 0xB8
};
#else
/* 16 级音量表：level 0~15 → ES8389 音量 0~255 */
const uint8_t es8389_vol_lut_16[16] = {
    0x00, 0x34, 0x4C, 0x5E, 0x6D, 0x79, 0x84, 0x8E,
    0x97, 0xA0, 0xA5, 0xA8, 0xB0, 0xB7, 0xBE, 0xBF
};
#endif

extern uint8_t battery_voltage_is_24V(void);

static uint8_t es8389_check_chip_id(void)
{
    uint8_t id0, id1;
    printf("Read ES8389 Chip ID ...\r\n");
    regmap_read(g_es8389_addr, ES8389_ID0_REG0xFD, &id0);
    regmap_read(g_es8389_addr, ES8389_ID1_REG0xFE, &id1);
    printf("ES8389 ChipID = 0x%02X%02X\r\n", id0, id1);
    
    if ((uint16_t)((id0 << 8) | id1) == ES8389_ID)
    {
        printf("Read es8389 id is right!\r\n");
        return 0;
    }
    else
    {
        printf("error: Read es8389 id.\r\n");
        return -1;
    }
}

/**
 * @brief es8389芯片上电初始化
 *
 */
void es8389_init(void)
{
//    uint32_t start_time = FREE_COUNTER_VALUE;
    
    if (battery_voltage_is_24V())
    {
        g_es8389_addr = ES8389_ADDR_8BITS_24V;
    }
    else
    {
        g_es8389_addr = ES8389_ADDR_8BITS_12V;
    }
//    printf("init 1: %u us\r\n", (start_time - FREE_COUNTER_VALUE));
    
    /* check es8389's id */
    //es8389_check_chip_id();
        
    es8389_open();
//    printf("init 2: %u us\r\n", (start_time - FREE_COUNTER_VALUE));
    
    /* delay 5 us to hold voltage stable */
    system_delay_us(5);
    
    es8389_set_adc_mute(true);  // true
    es8389_set_dac_mute(true);  // true
    es8389_set_bits_per_sample(ES8389_S16_LE);
    es8389_config_fmt(ES_I2S_NORMAL);
    
    /* Notes: Here, to enter in standby mode, write registers directly 
     * in order that saves delay time 
     */
    #if 0
    //es8389_set_bias(false);
    regmap_update_bits(g_es8389_addr, ES8389_DAC_CONTROL_REG0x40, 0x03, 0x03);
    regmap_write(g_es8389_addr, ES8389_CLK_MANAGER_REG0x10, 0xD4);
    //system_delay_us(70 * 1000);
    system_delay_us(100);
    
    regmap_write(g_es8389_addr, ES8389_ANALOG_CONTROL_REG0x61, 0x59);
    regmap_write(g_es8389_addr, ES8389_ANALOG_CONTROL_REG0x64, 0x00);
    regmap_write(g_es8389_addr, ES8389_CLK_MANAGER_REG0x03, 0x00);
    regmap_write(g_es8389_addr, ES8389_RESET_REG0x00, 0x7E);
    regmap_update_bits(g_es8389_addr, ES8389_DAC_CONTROL_REG0x40, 0x03, 0x00);
    #endif
//    printf("init 3: %u us\r\n", (start_time - FREE_COUNTER_VALUE));

    // es8389_set_vol(0x8f);
    // es8389_set_mic_gain(ES8389_MIC_GAIN_36_5DB);
    es8389_init_play_vol(es8389_vol_lut_16[8]);		// 0x8F vol is very small, 0xBF is small.
    
    /* 
     * 12 is the largest gain. The default gain is set 6.
     * Set the value of mic gain 12 for removing AEC.
     * by chuzewei on 20260421
     */
    es8389_init_mic_gain(12);   // 12  6 
    
    #if 0
    es8389_set_config(ES8389_STANDY, 16000);
    #else
    es8389_init_config(ES8389_STANDY, 16000);
    #endif

    /* check all registers. */
    //es8389_read_all_reg();
 //   printf("init 4: %u us\r\n", (start_time - FREE_COUNTER_VALUE));
}

/**
 * @brief 配置仅播放模式以及采样率
 *
 * @param sample_rate
 */
void es8389_play_init(uint32_t sample_rate)
{
    es8389_set_config(ES8389_PLAY, sample_rate);

    // test
    // es8389_play_start();
}

/**
 * @brief 开始播放音乐，启动codec，取消mute dac
 *
 */
void es8389_play_start(void)
{
    es8389_set_bias(true);
    es8389_set_dac_mute(false);
}
// standy省电
/**
 * @brief 播放结束进入待机模式，关闭codec，并mute dac
 *
 */
void es8389_play_stop(void)
{
    es8389_set_dac_mute(true);
    es8389_set_bias(false);
}

/**
 * @brief 配置仅录音模式以及采样率
 *
 * @param sample_rate
 */
void es8389_mic_init(uint32_t sample_rate)
{
    es8389_set_config(ES8389_MIC, sample_rate);

    // test
    // es8389_mic_start();
}

/**
 * @brief 开始录音，启动codec，取消mute adc
 *
 */
void es8389_mic_start(void)
{
    es8389_set_bias(true);
    es8389_set_adc_mute(false);

    // xTimerStart(mic_5s_timer, NULL);
}

/**
 * @brief 录音结束进入待机模式，关闭codec，并mute adc
 *
 */
void es8389_mic_stop(void)
{
    es8389_set_adc_mute(true);
    es8389_set_bias(false);
}

/**
 * @brief 配置播放+录音模式以及采样率
 *
 * @param sample_rate
 */
void es8389_play_and_mic_init(uint32_t sample_rate)
{
    es8389_set_config(ES8389_PLAY_AND_MIC, sample_rate);

    // test
    // es8389_play_start();
    // es8389_mic_start();
}

void es8389_standby_init(void)
{
    es8389_set_config(ES8389_STANDY, 16000);
}


void es8389_loop_init(uint32_t sample_rate)
{
    es8389_set_config(ES8389_LOOP, sample_rate);
}

void es8389_loop_start(void)
{
    es8389_set_bias(true);
    es8389_set_adc_mute(false);
    es8389_set_dac_mute(false);
}

void es8389_loop_stop(void)
{
    es8389_set_adc_mute(true);
    es8389_set_dac_mute(true);
    es8389_set_bias(false);
}

/**
 * @brief 打印当前的模式
 *
 * @param mode
 */
static void print_es8389_mode(es8389_mode_e mode)
{
    switch (mode)
    {
    case ES8389_STANDY:
        printf("Mode: Standby\r\n");
        break;
    case ES8389_MIC:
        printf("Mode: Microphone Only\r\n");
        break;
    case ES8389_PLAY:
        printf("Mode: Playback Only\r\n");
        break;
    case ES8389_LOOP:
        printf("Mode: LOOP\r\n");
        break;
    case ES8389_PLAY_AND_MIC:
        printf("Mode: Playback and Microphone\r\n");
        break;
    default:
        printf("Mode: Unknown\n");
        break;
    }
}

/**
 * @brief 配置es8389的输入输出模式以及采样率
 *
 * @param mode
 * @param sample_rate
 */
static void es8389_set_config(es8389_mode_e mode, uint32_t sample_rate)
{
    if ((mode == es_info.mode) && (sample_rate == es_info.now_sample_rate))
    {
        // printf("No need for modification. This configuration is already in place.\r\n");
        return;
    }
    else
    {
        es_info.now_sample_rate = sample_rate;
        es_info.mode = mode;
        print_es8389_mode(mode);
        printf("now_sample_rate = %d\r\n", es_info.now_sample_rate);
    }

    es8389_set_adc_mute(true);
    es8389_set_dac_mute(true);
    es8389_set_bias(false);

    if (sample_rate == 8000 || sample_rate == 16000)
    {
        es8389_config_sample(sample_rate, 32);
    }
    else if (sample_rate == 44100 || sample_rate == 48000)
    {
        es8389_config_sample(sample_rate, 64);
    }

    // switch (mode)
    // {
    // case ES8389_STANDY:
    // {
    //     es8389_set_adc_mute(true);
    //     es8389_set_dac_mute(true);
    //     es8389_set_bias(false);
    // }
    // break;
    // case ES8389_MIC:
    // {
    //     es8389_mic_start();
    // }
    // break;
    // case ES8389_PLAY:
    // {
    //     es8389_play_start();
    // }
    // break;
    // case ES8389_PLAY_AND_MIC:
    // {
    //     es8389_play_start();
    //     es8389_mic_start();
    // }
    // break;

    // default:
    //     break;
    // }
}

/**
 * @brief 配置es8389 初始化阶段的输入输出模式以及采样率
 *
 * @param mode
 * @param sample_rate
 */
static void es8389_init_config(es8389_mode_e mode, uint32_t sample_rate)
{
    es_info.now_sample_rate = sample_rate;
    es_info.mode = mode;
    
    print_es8389_mode(mode);
    printf("now_sample_rate = %d\r\n", es_info.now_sample_rate);

    //es8389_set_adc_mute(true);
    //es8389_set_dac_mute(true);
    
    #if 1
    /* 
     * turn off bias 
     * omit delay time 70 ms here.
     */
    //es8389_set_bias(false);
    regmap_update_bits(g_es8389_addr, ES8389_DAC_CONTROL_REG0x40, 0x03, 0x03);
    regmap_write(g_es8389_addr, ES8389_CLK_MANAGER_REG0x10, 0xD4);
    //system_delay_us(70 * 1000);
    system_delay_us(100);
    
    regmap_write(g_es8389_addr, ES8389_ANALOG_CONTROL_REG0x61, 0x59);
    regmap_write(g_es8389_addr, ES8389_ANALOG_CONTROL_REG0x64, 0x00);
    regmap_write(g_es8389_addr, ES8389_CLK_MANAGER_REG0x03, 0x00);
    regmap_write(g_es8389_addr, ES8389_RESET_REG0x00, 0x7E);
    regmap_update_bits(g_es8389_addr, ES8389_DAC_CONTROL_REG0x40, 0x03, 0x00);
    #endif

    if (sample_rate == 8000 || sample_rate == 16000)
    {
        es8389_config_sample(sample_rate, 32);
    }
    else if (sample_rate == 44100 || sample_rate == 48000)
    {
        es8389_config_sample(sample_rate, 64);
    }
}

/**
 * @brief 读取es8389的值
 *
 */
void es8389_read_all_reg(void)
{
    uint8_t regv;
    printf("\r\nread reg:\r\n");
    
    #if 0
    for (size_t i = 0; i < 0xff; i++)
    {
        regmap_read(g_es8389_addr, i, &regv);
        printf("reg[%02X]: %02X\r\n", i, regv);
    }
    #else
    for (size_t i = 0; i < 0xff; i += 0x10)
    {
        printf("reg[%02X-%02X]: ", i, i + 0xF);
        for (size_t j = 0; j <= 0x0f; j++)
        {
            regmap_read(g_es8389_addr, (i + j), &regv);
            if (j == 7)
            {
                printf("%02X   ", regv);
            }
            else 
            {
                printf("%02X ", regv);
            }
            if (j == 0x0f)
            {
                printf("\r\n");
            }            
        }
    }
    #endif
    printf("\r\nend\r\n");
}

/**
 * @brief 设置输出音频的音频
 *
 * @param vol
 */
void es8389_init_play_vol(uint8_t vol)
{
    printf("es8389_init_play_vol: %x\r\n", vol);
    es8389_set_vol(vol);
}

/**
 * @brief 设置输入mic的增益
 *
 * @param gain_db 范围0~12
 */
void es8389_init_mic_gain(uint8_t gain_db)
{
    es8389_mic_gain_t gain;

    switch (gain_db)
    {
    case 0:
        gain = ES8389_MIC_GAIN_0DB;
        break;
    case 1:
        gain = ES8389_MIC_GAIN_3_5DB;
        break;
    case 2:
        gain = ES8389_MIC_GAIN_6_5DB;
        break;
    case 3:
        gain = ES8389_MIC_GAIN_9_5DB;
        break;
    case 4:
        gain = ES8389_MIC_GAIN_12_5DB;
        break;
    case 5:
        gain = ES8389_MIC_GAIN_15_5DB;
        break;
    case 6:
        gain = ES8389_MIC_GAIN_18_5DB;
        break;
    case 7:
        gain = ES8389_MIC_GAIN_21_5DB;
        break;
    case 8:
        gain = ES8389_MIC_GAIN_24_5DB;
        break;
    case 9:
        gain = ES8389_MIC_GAIN_27_5DB;
        break;
    case 10:
        gain = ES8389_MIC_GAIN_30_5DB;
        break;
    case 11:
        gain = ES8389_MIC_GAIN_33_5DB;
        break;
    case 12:
        gain = ES8389_MIC_GAIN_36_5DB;
        break;
    default:
        printf("out of mic gain range\r\n");
        return;
    }

    es8389_set_mic_gain(gain);
}

//////////////////////////////////////////// es8389 驱动部分 ////////////////////////////////////////////////////////////////////
static void es8389_open(void)
{
    regmap_write(g_es8389_addr, ES8389_ISOLATION_CONTROL_REG0xF3, 0x00);
    regmap_write(g_es8389_addr, ES8389_RESET_REG0x00, 0x7E);
    regmap_write(g_es8389_addr, ES8389_ISOLATION_CONTROL_REG0xF3, 0x38);
    regmap_write(g_es8389_addr, ES8389_ADC_SP_CONTROL_REG0x24, 0x64);
    regmap_write(g_es8389_addr, ES8389_ADC_SP_CONTROL_REG0x25, (int)(0x04 + (0 << 6) + (0 << 5)));
    regmap_write(g_es8389_addr, ES8389_DAC_CONTROL_REG0x45, (int)(0x03 + (0 << 6) + (0 << 5)));
    regmap_write(g_es8389_addr, ES8389_VMID_CONTROL_REG0x60, 0x2A);
    regmap_write(g_es8389_addr, ES8389_ANALOG_CONTROL_REG0x61, 0xC9);
    regmap_write(g_es8389_addr, ES8389_ANALOG_CONTROL_REG0x62, 0x4F);
    regmap_write(g_es8389_addr, ES8389_ANALOG_CONTROL_REG0x63, 0x06);
    regmap_write(g_es8389_addr, ES8389_ANALOG_CONTROL_REG0x6B, 0x00);
    regmap_write(g_es8389_addr, ES8389_ANALOG_CONTROL_REG0x6D, (int)(0x16 + (0 & 0xC0)));
    regmap_write(g_es8389_addr, ES8389_ANALOG_CONTROL_REG0x6E, 0xAA);
    regmap_write(g_es8389_addr, ES8389_ANALOG_CONTROL_REG0x6F, 0x66);
    regmap_write(g_es8389_addr, ES8389_ANALOG_CONTROL_REG0x70, 0x99);

    if (ES8389_Analog_DriveSel == ES8389_DriveSel_LowPower)
    {
        regmap_write(g_es8389_addr, ES8389_ANALOG_CONTROL_REG0x6B, 0x80);
        regmap_write(g_es8389_addr, ES8389_ANALOG_CONTROL_REG0x6C, 0x0F);
        regmap_write(g_es8389_addr, ES8389_ANALOG_CONTROL_REG0x70, 0x66);
    }

    regmap_write(g_es8389_addr, ES8389_ADC_SP_CONTROL_REG0x23, (int)(0x00 + (0 & 0xC0) + (0 << 2) + (0 & 0x03)));
    regmap_write(g_es8389_addr, ES8389_PGA1_GAIN_CONTROL_REG0x72, (int)((1 << 4) + 0));
    regmap_write(g_es8389_addr, ES8389_PGA1_GAIN_CONTROL_REG0x73, (int)((1 << 4) + 0));
    regmap_write(g_es8389_addr, ES8389_CLK_MANAGER_REG0x10, 0xC4);
    regmap_write(g_es8389_addr, ES8389_MISC_CONTROL_REG0x01, (int)(0x08 + (0 << 7) + (0 << 6) + (0 << 5) + (0 << 0)));
    regmap_write(g_es8389_addr, ES8389_CSM_STATE_REG0xF1, 0x00);
    regmap_write(g_es8389_addr, 0x12, 0x01);
    regmap_write(g_es8389_addr, 0x13, 0x01);
    regmap_write(g_es8389_addr, 0x14, 0x01);
    regmap_write(g_es8389_addr, 0x15, 0x01);
    regmap_write(g_es8389_addr, 0x16, 0x35);
    regmap_write(g_es8389_addr, 0x17, 0x09);
    regmap_write(g_es8389_addr, 0x18, 0x91);
    regmap_write(g_es8389_addr, 0x19, 0x28);
    regmap_write(g_es8389_addr, 0x1A, 0x01);
    regmap_write(g_es8389_addr, 0x1B, 0x01);
    regmap_write(g_es8389_addr, 0x1C, 0x11);
    regmap_write(g_es8389_addr, ES8389_ADC_SP_CONTROL_REG0x2A, (int)(0x00 + (0 << 4)));
    
    // mute ADC1 and ADC2
    regmap_write(g_es8389_addr, ES8389_ADC_SP_CONTROL_REG0x20, 
                 (int)(0x00 + ES8389_S16_LE + (0 << 4) + ES8389_DAIFMT_I2S + (0 << 1) + (0 << 0)));
    
    // mute DAC1 and DAC2
    regmap_write(g_es8389_addr, ES8389_DAC_CONTROL_REG0x40, 
                 (int)(0x00 + ES8389_S16_LE + (0 << 4) + ES8389_DAIFMT_I2S + (0 << 1) + (0 << 0)));
                 
    regmap_write(g_es8389_addr, ES8389_CHIP_MISC_CONTROL_REG0xF0, (int)(0x13));
    regmap_write(g_es8389_addr, ES8389_CLK_MANAGER_REG0x02, (int)(0x00 + (0 << 6) + (0 << 1) + (0 << 0)));
    regmap_write(g_es8389_addr, ES8389_CLK_MANAGER_REG0x04, 0x00);
    regmap_write(g_es8389_addr, ES8389_CLK_MANAGER_REG0x05, 0x10);
    regmap_write(g_es8389_addr, ES8389_CLK_MANAGER_REG0x06, 0x00);
    regmap_write(g_es8389_addr, ES8389_CLK_MANAGER_REG0x07, 0xC0);
    regmap_write(g_es8389_addr, ES8389_CLK_MANAGER_REG0x08, 0x00);
    regmap_write(g_es8389_addr, ES8389_CLK_MANAGER_REG0x09, 0xC0);
    regmap_write(g_es8389_addr, ES8389_CLK_MANAGER_REG0x0A, 0x80);
    regmap_write(g_es8389_addr, ES8389_CLK_MANAGER_REG0x0B, 4);

    regmap_write(g_es8389_addr, ES8389_CLK_MANAGER_REG0x0C, (int)(256 >> 8));
    regmap_write(g_es8389_addr, ES8389_CLK_MANAGER_REG0x0D, (int)(256 & 0xFF));

    regmap_write(g_es8389_addr, ES8389_CLK_MANAGER_REG0x0F, 0x10);
    regmap_write(g_es8389_addr, ES8389_ADC_SP_CONTROL_REG0x21, 0x1F);
    regmap_write(g_es8389_addr, ES8389_ADC_SP_CONTROL_REG0x22, 0x7F);
    regmap_write(g_es8389_addr, ES8389_ADC_SP_CONTROL_REG0x2F, 0xC0);
    regmap_write(g_es8389_addr, 0x30, 0xF4);
    regmap_write(g_es8389_addr, ES8389_ADC_SP_CONTROL_REG0x31, (int)(0x00 + (0 << 7) + (0 << 6)));
    regmap_write(g_es8389_addr, ES8389_DAC_CONTROL_REG0x44, (int)(0x00 + (0 << 3) + (0 << 2) + (0 << 1) + (0 << 0)));
    regmap_write(g_es8389_addr, ES8389_DAC_CONTROL_REG0x41, 0x7F);
    regmap_write(g_es8389_addr, ES8389_DAC_CONTROL_REG0x42, 0x7F);
    regmap_write(g_es8389_addr, ES8389_DAC_CONTROL_REG0x43, 0x10);
    regmap_write(g_es8389_addr, ES8389_DAC_CONTROL_REG0x49, (int)(0x0F + (0 << 4)));
    regmap_write(g_es8389_addr, 0x4C, 0xC0);

    regmap_write(g_es8389_addr, ES8389_RESET_REG0x00, 0x00);
    regmap_write(g_es8389_addr, ES8389_CLK_MANAGER_REG0x03, 0xC1);
    regmap_write(g_es8389_addr, ES8389_RESET_REG0x00, 0x01);
    regmap_write(g_es8389_addr, ES8389_DAC_CONTROL_REG0x4D, 0x02);

    regmap_write(g_es8389_addr, ES8389_ADC_SP_CONTROL_REG0x26, 191);
    regmap_write(g_es8389_addr, ES8389_ADC_SP_CONTROL_REG0x27, 191);
    regmap_write(g_es8389_addr, ES8389_ADC_SP_CONTROL_REG0x28, 191);
    regmap_write(g_es8389_addr, ES8389_DAC_CONTROL_REG0x46, 191);
    regmap_write(g_es8389_addr, ES8389_DAC_CONTROL_REG0x47, 191);
    regmap_write(g_es8389_addr, ES8389_DAC_CONTROL_REG0x48, (int)(95 << 1));
    
    /* Don't use internal pull down.
     * Added by chuzewei on 2026/03/16 
     */
    regmap_write(g_es8389_addr, ES8389_PULL_DOWN_CONTROL_REG0xF2, 0x00);

    printf("es8389 work in Slave mode\r\n");
    // 配置es8389为从机模式
    regmap_update_bits(g_es8389_addr, ES8389_MISC_CONTROL_REG0x01, ES8389_MASK_MSModeSel, 0);

    // Select clock source for internal mclk
    // 选择内部时钟作为mclk的时钟源
    regmap_update_bits(g_es8389_addr, ES8389_CLK_MANAGER_REG0x02, 0xC0, 1 << 6);

    // 控制 ES8389 不对外部输入的 MCLK（主时钟）做反相处理
    regmap_update_bits(g_es8389_addr, ES8389_CLK_MANAGER_REG0x02, 0x02, 0 << 1);

    // Set ADC and DAC data format
    // 使用 ES8389 内部作为参考源
    /* set internal reference signal (ADCL + DACR) */
    regmap_write(g_es8389_addr, ES8389_CHIP_MISC_CONTROL_REG0xF0, (int)(0x12 + (1 << 3) + (0 << 2)));
    printf("Set internal reference signal\r\n");

    // SCLK inverted or not
    // 控制bclk不反相
    regmap_update_bits(g_es8389_addr, ES8389_CLK_MANAGER_REG0x02, 0x01, 0 << 0);
}

static int get_coeff(uint32_t mclk, uint32_t rate)
{
    for (int i = 0; i < (sizeof(coeff_div) / sizeof(coeff_div[0])); i++)
    {
        if (coeff_div[i].Ratio == rate && coeff_div[i].MCLK == mclk)
        {
            return i;
        }
    }

    return -1;
}

/**
 * @brief
 *
 * @param sample_rate
 * @param bits
 */
static void es8389_config_sample(int sample_rate, int bits)
{

    // int mclk_fre = sample_rate * bits * 2;
    int mclk_fre = sample_rate * bits;
    int rate = mclk_fre / sample_rate;

    int coeff = get_coeff(mclk_fre, rate);
    // int coeff = 55;//33;
    printf("coeff = %d\r\n", coeff);

    if (coeff < 0)
    {
        printf("Unable to configure sample rate %dHz with %dHz MCLK\r\n", sample_rate, mclk_fre);
        return;
    }
    else
    {
        regmap_write(g_es8389_addr, ES8389_CLK_MANAGER_REG0x04, coeff_div[coeff].Reg0x04);
        regmap_write(g_es8389_addr, ES8389_CLK_MANAGER_REG0x05, coeff_div[coeff].Reg0x05);
        regmap_write(g_es8389_addr, ES8389_CLK_MANAGER_REG0x06, coeff_div[coeff].Reg0x06);
        regmap_write(g_es8389_addr, ES8389_CLK_MANAGER_REG0x07, coeff_div[coeff].Reg0x07);
        regmap_write(g_es8389_addr, ES8389_CLK_MANAGER_REG0x08, coeff_div[coeff].Reg0x08);
        regmap_write(g_es8389_addr, ES8389_CLK_MANAGER_REG0x09, coeff_div[coeff].Reg0x09);
        regmap_write(g_es8389_addr, ES8389_CLK_MANAGER_REG0x0A, coeff_div[coeff].Reg0x0A);
        regmap_update_bits(g_es8389_addr, ES8389_CLK_MANAGER_REG0x0F, 0xC0, coeff_div[coeff].Reg0x0F);
        regmap_write(g_es8389_addr, ES8389_CLK_MANAGER_REG0x11, coeff_div[coeff].Reg0x11);
        regmap_write(g_es8389_addr, ES8389_ADC_SP_CONTROL_REG0x21, coeff_div[coeff].Reg0x21);
        regmap_write(g_es8389_addr, ES8389_ADC_SP_CONTROL_REG0x22, coeff_div[coeff].Reg0x22);
        regmap_write(g_es8389_addr, ES8389_ADC_SP_CONTROL_REG0x26, coeff_div[coeff].Reg0x26);
        regmap_update_bits(g_es8389_addr, 0x30, 0xC0, coeff_div[coeff].Reg0x30);
        regmap_write(g_es8389_addr, ES8389_DAC_CONTROL_REG0x41, coeff_div[coeff].Reg0x41);
        regmap_write(g_es8389_addr, ES8389_DAC_CONTROL_REG0x42, coeff_div[coeff].Reg0x42);
        regmap_update_bits(g_es8389_addr, ES8389_DAC_CONTROL_REG0x43, 0x81, coeff_div[coeff].Reg0x43);
        regmap_update_bits(g_es8389_addr, ES8389_CHIP_MISC_CONTROL_REG0xF0, 0x73, coeff_div[coeff].Reg0xF0);
        regmap_write(g_es8389_addr, ES8389_CSM_STATE_REG0xF1, coeff_div[coeff].Reg0xF1);
        regmap_write(g_es8389_addr, 0x16, coeff_div[coeff].Reg0x16);
        regmap_write(g_es8389_addr, 0x18, coeff_div[coeff].Reg0x18);
        regmap_write(g_es8389_addr, 0x19, coeff_div[coeff].Reg0x19);
    }
}

/**
 * @brief 设置有效采样位宽
 *
 * @param bits
 */
static void es8389_set_bits_per_sample(int bits)
{
    int state = 0;

    switch (bits)
    {
    case 16:
    default:
        state |= ES8389_S16_LE;
        break;
    case 18:
        state |= ES8389_S18_LE;
        break;
    case 20:
        state |= ES8389_S20_LE;
        break;
    case 24:
        state |= ES8389_S24_LE;
        break;
    case 32:
        state |= ES8389_S32_LE;
        break;
    }

    regmap_update_bits(g_es8389_addr, ES8389_ADC_SP_CONTROL_REG0x20, ES8389_MASK_DATALEN, state);
    regmap_update_bits(g_es8389_addr, ES8389_DAC_CONTROL_REG0x40, ES8389_MASK_DATALEN, state);
}

/**
 * @brief 数字音频接口（DAI）格式配置函数
 *
 * @param fmt
 */
static void es8389_config_fmt(es_i2s_fmt_t fmt)
{
    int state = 0;

    switch (fmt)
    {
    case ES_I2S_NORMAL:
        printf("es8389 in I2S Format\r\n");
        state |= ES8389_DAIFMT_I2S;
        regmap_update_bits(g_es8389_addr, ES8389_CLK_MANAGER_REG0x0C, 0xE0, 0x00);
        break;
    case ES_I2S_LEFT:
    case ES_I2S_RIGHT:
        printf("es8389 in LJ Format\r\n");
        state |= ES8389_DAIFMT_LEFT_J;
        regmap_update_bits(g_es8389_addr, ES8389_CLK_MANAGER_REG0x0C, 0xE0, 0x40);
        break;
    case ES_I2S_DSP:
        printf("es8389 in DSP-A Format\r\n");
        state |= ES8389_DAIFMT_DSP_A;
        regmap_update_bits(g_es8389_addr, ES8389_CLK_MANAGER_REG0x0C, 0xE0, 0x80);
        break;
    default:
        printf("es8389 in DSP-B Format\r\n");
        state |= ES8389_DAIFMT_DSP_B;
        regmap_update_bits(g_es8389_addr, ES8389_CLK_MANAGER_REG0x0C, 0xE0, 0xA0);
        break;
    }

    regmap_update_bits(g_es8389_addr, ES8389_ADC_SP_CONTROL_REG0x20, ES8389_MASK_DAIFMT, state);
    regmap_update_bits(g_es8389_addr, ES8389_DAC_CONTROL_REG0x40, ES8389_MASK_DAIFMT, state);
}

static void es8389_set_bias(bool ret)
{

    if (ret)
    {
        es8389_set_bias_on();
    }
    else
    {
        es8389_set_bias_standby();
    }
}

static void es8389_set_bias_standby(void)
{
    regmap_update_bits(g_es8389_addr, ES8389_DAC_CONTROL_REG0x40, 0x03, 0x03);
    regmap_write(g_es8389_addr, ES8389_CLK_MANAGER_REG0x10, 0xD4);
    system_delay_us(70 * 1000);
    //system_delay_us(100);
    
    regmap_write(g_es8389_addr, ES8389_ANALOG_CONTROL_REG0x61, 0x59);
    regmap_write(g_es8389_addr, ES8389_ANALOG_CONTROL_REG0x64, 0x00);
    regmap_write(g_es8389_addr, ES8389_CLK_MANAGER_REG0x03, 0x00);
    regmap_write(g_es8389_addr, ES8389_RESET_REG0x00, 0x7E);
    regmap_update_bits(g_es8389_addr, ES8389_DAC_CONTROL_REG0x40, 0x03, 0x00);
}

static void es8389_set_bias_on(void)
{
    regmap_write(g_es8389_addr, ES8389_DAC_CONTROL_REG0x4D, 0x02);
    regmap_update_bits(g_es8389_addr, ES8389_ANALOG_CONTROL_REG0x69, 0x20, 0x20);
    regmap_write(g_es8389_addr, ES8389_ANALOG_CONTROL_REG0x61, 0xD9);
    regmap_write(g_es8389_addr, ES8389_ANALOG_CONTROL_REG0x64, 0x8F);
    regmap_write(g_es8389_addr, ES8389_CLK_MANAGER_REG0x10, 0xE4);
    regmap_write(g_es8389_addr, ES8389_RESET_REG0x00, 0x01);
    // regmap_write(g_es8389_addr, ES8389_CLK_MANAGER_REG0x03, 0xC3);
    // regmap_write(g_es8389_addr, ES8389_CLK_MANAGER_REG0x03, 0x82);
    regmap_write(g_es8389_addr, ES8389_CLK_MANAGER_REG0x03, 0xC2);
    regmap_write(g_es8389_addr, ES8389_ADC_SP_CONTROL_REG0x24, 0x6A);
    regmap_write(g_es8389_addr, ES8389_ADC_SP_CONTROL_REG0x25, (uint8_t)(0x0A + (0 << 6) + (0 << 5)));
}

/**
 * @brief 配置音量
 *
 * @param vol
 */
static void es8389_set_vol(uint8_t vol)
{
    regmap_write(g_es8389_addr, ES8389_DAC_CONTROL_REG0x46, (uint8_t)vol);
    regmap_write(g_es8389_addr, ES8389_DAC_CONTROL_REG0x47, (uint8_t)vol);
}

void es8389_get_vol(uint8_t * vol1, uint8_t * vol2)
{
    regmap_read(g_es8389_addr, ES8389_DAC_CONTROL_REG0x46, (uint8_t*)vol1);
    regmap_read(g_es8389_addr, ES8389_DAC_CONTROL_REG0x47, (uint8_t*)vol2);
}

void es8389_set_adc_mute(bool mute)
{
    uint8_t regv;
    regmap_read(g_es8389_addr, ES8389_ADC_SP_CONTROL_REG0x20, &regv);
    regv &= 0xFC;
    if (mute)
    {
        regv |= 0x03;
    }
    regmap_write(g_es8389_addr, ES8389_ADC_SP_CONTROL_REG0x20, regv);
}

void es8389_set_dac_mute(bool mute)
{

    uint8_t regv;
    regmap_read(g_es8389_addr, ES8389_DAC_CONTROL_REG0x40, &regv);
    regv &= 0xFC;
    if (mute)
    {
        regv |= 0x03;
    }
    regmap_write(g_es8389_addr, ES8389_DAC_CONTROL_REG0x40, regv);
}

/**
 * @brief 配置mic的增益
 *
 * @param gain_db
 */
static void es8389_set_mic_gain(es8389_mic_gain_t gain_db)
{

    // 左声道
    regmap_write(g_es8389_addr, ES8389_PGA1_GAIN_CONTROL_REG0x72, gain_db | (1 << 4));
    // 右声道
    regmap_write(g_es8389_addr, ES8389_PGA1_GAIN_CONTROL_REG0x73, gain_db | (1 << 4));
}

/*
 * engineering mode.
 */
void em_es8389_write(uint8_t reg, uint8_t regv)
{
    regmap_write(g_es8389_addr, reg, regv);
    //printf("Write: addr: 0x%x, reg: 0x%x, val: 0x%x\r\n", g_es8389_addr, reg, regv);
}

uint8_t em_es8389_read(uint8_t reg)
{
    uint8_t data;
    regmap_read(g_es8389_addr, reg, &data);
    //printf("Read: addr: 0x%x, reg: 0x%x, val: 0x%x\r\n", g_es8389_addr, reg, data);
    return data;
}

