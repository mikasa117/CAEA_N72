/* polyspace<MISRA-C3:1.1:Not a defect:Justified> Too many macro definitions code are generated by Configuration tools ,such as:Vector Geny. */
/*******************************************************************************
|  File Name: Can_Main.c
|  Description: .c file of Can_Main
|-------------------------------------------------------------------------------
|  (c)This software is the proprietary of Wenzhou Changjiang AutoMobile (CAEA).
|     All rights are reserved by CAEA.
|-------------------------------------------------------------------------------
| Initials      Name                   Company
| --------      ---------------------  -----------------------------------------
|               Qiuxiaojian            CAEA
|-------------------------------------------------------------------------------
|               R E V I S I O N   H I S T O R Y
|-------------------------------------------------------------------------------
| Date          Version      Author    Description
| ------------  --------     -------   -----------------------------------------
| 20171009      1.0.0        kenw       Primary edition.
| 20171025      1.0.1        kenw       
|                                       
||******************************************************************************/


/*******************************************************************************
|    Other Header File Inclusion
|******************************************************************************/
#include "il_inc.h"
#include "Platform_Types.h"
#include "CanApp.h"
#include "Can_Trcv.h"
#include "sdk_project_config.h"
#include "CanNm.h"
#include "ccl_inc.h"
#include "v_inc.h"
#include "interrupt_manager.h"
#include "Random.h"
#include "pins_driver.h"
#include "CanDem.h"
#include "appdesc.h"
#include "Can_Main.h"
#include "can_config.h"
#include "CanDem.h"
#include "Random.h"
/*******************************************************************************
|    Macro Definition
|******************************************************************************/

#define RX_MESSAGE_BUFFER_NUM (9)
#define TX_MESSAGE_BUFFER_NUM (8)
#define EXAMPLE_CAN CAN3
/* Select OSC24Mhz as master flexcan clock source */
#define FLEXCAN_CLOCK_SOURCE_SELECT (1U)
/* Clock divider for master flexcan clock source */
#define FLEXCAN_CLOCK_SOURCE_DIVIDER (1U)

#define EXAMPLE_CAN_CLK_FREQ ((CLOCK_GetRootClockFreq(kCLOCK_Root_Can3) / 100000U) * 100000U)
/*#define CeCanMain_u_canChannel  0u*/


/* polyspace<MISRA-C3:2.5:Not a defect:Justified> the value define of Local KL15 on in CanMain, reserve */
#define CeCanMain_u_LocalKL15On   1u
#define CeCanMain_u_LocalKL15Off  0u

/* polyspace<MISRA-C3:2.5:Not a defect:Justified> the value define of Vbat mode normal in CanMain, reserve */
#define CeCanMain_u_VbatMNormal  (uint8)1u
#define CeCanMain_u_VbatMAbnormal  (uint8)0u
#define CeCanMain_u_True                         (uint8)1U
#define CeCanMain_u_False                        (uint8)0U

#define CeCanMain_w_ComKeepTime        1010u
#define CeCanMain_w_SleepTime        500u
#define CeCanMain_w_StartUpTime        2u
/* polyspace<MISRA-C3:2.5:Not a defect:[STATUS]> the value define of Vbat mode normal in CanMain, reserve */
#define CeCanMain_w_Zero            (uint8)0u
/******************************************************************************/
/*********************************�꿪��  **********************************/
/* polyspace<MISRA-C3:2.5:Not a defect:Justified> Not affect */
#define POWER_ON_OSEK_ACTIVE                                 /**  �ϵ�5S�� ���缤��ʱ��  **/
/******************************************************************************/





/*******************************************************************************
|    Enum Definition
|******************************************************************************/

/*******************************************************************************
|    Typedef Definition
|******************************************************************************/

/*******************************************************************************
|    Global variables Declaration
|******************************************************************************/

/*******************************************************************************
|    Static local variables Declaration
|******************************************************************************/


/* polyspace<MISRA-C3:8.8:Not a defect:Justified> Not affect */

/*static uint8 SeCanMain_u_LocalKL15Cnt;*/

static uint8     SeCanMain_u_Start5SFlag;
static uint8     SeCanMain_u_5SCount;
static uint8     SeCanMain_u_StartRxTimeout;

static uint8     SeCanMain_u_ResetFlag;
/*******************************************************************************
|    static Local Functions Declaration
|******************************************************************************/
static void CanMain_AllVarInit( void );
static void CanMain_AllModuInit( void );
static void CanMain_IntEnableIRQFunction( void );
//#pragma section text Code_Can_Main

static void CanMain_AllVarInit( void )
{
    CanApp_InitMemory();
    CanDem_InitMemory();
}

static void CanMain_AllModuInit( void )
{
  CclInitPowerOn();
  CanMain_AllVarInit();
  CanApp_InitMemory();
  SeCanMain_u_Start5SFlag = 0u;
  SeCanMain_u_5SCount = 250U;
}

/*******************************************************************************
Name            :
Syntax            :
Sync/Async        : Synchronous
Reentrancy        :
Parameters(in)    : None                        :-
Parameters(out) : None                        :-
Return value    : None                        :-
Description        : Receive  Notification
Call By            :
history
<No.>    <author>    <time>    <description>
1
|******************************************************************************/
void CanMain_InitKamMemory( void )
{

}
/*******************************************************************************
Name            :
Syntax            :
Sync/Async        : Synchronous
Reentrancy        :
Parameters(in)    : None                        :-
Parameters(out) : None                        :-
Return value    : None                        :-
Description        : Receive  Notification
Call By            :
history
<No.>    <author>    <time>    <description>
1
|******************************************************************************/
void CanMain_InitMemory( uint8 LeCanMain_u_Src )
{
    switch(LeCanMain_u_Src)
    {
        case 0u:
        {
            (void)FLEXCAN_DRV_Init(flexcanInitConfig0_INST,&flexcanInitConfig0_State,&flexcanInitConfig0);
            CanMain_AllModuInit();
            break;
        }
        case 1u:
        {
            CanMain_AllVarInit();
            break;
        }
        default:
        {
            CanMain_AllModuInit();
            break;
        }
    }
    CanMain_IntEnableIRQFunction();
}
/*******************************************************************************
Name            :
Syntax            :
Sync/Async        :
Reentrancy        :
Parameters(in)    :
Parameters(out) :
Return value    :
Description        :
Call By            :
history
<No.>    <author>    <time>      <description>
  1      kenw        20170930    creation
|******************************************************************************/
void CanMain_5msAMainFunction( void )
{
    
}

/*******************************************************************************
Name            :
Syntax            :
Sync/Async        :
Reentrancy        :
Parameters(in)    :
Parameters(out) :
Return value    :
Description        :
Call By            :
history
<No.>    <author>    <time>      <description>
  1      kenw        20170930    creation
|******************************************************************************/
void CanMain_5msBMainFunction( void )
{

    CanTrcv_MainFunction();
    Ccl_5_0msTaskCont();
    CanApp_MainFunction();
    
	
	//  ggl 2025/12/11
	if(CanDem_DcmGet_NetDtc_EnableConditionStatus() == 0u)
	{
		SeCanMain_u_StartRxTimeout = 0;
	}
    else if((CanDem_DcmGet_NetDtc_EnableConditionStatus() == 1u) && (SeCanMain_u_StartRxTimeout == 0U) )
    {
		IlRxStop();
		IlRxStart();
		SetCanApp_ClearTimeOut();
		SeCanMain_u_StartRxTimeout = 1U;
    }
    else
	{
    	
    }
}

/*******************************************************************************
Name            :
Syntax            :
Sync/Async        :
Reentrancy        :
Parameters(in)    :
Parameters(out) :
Return value    :
Description        :
Call By            :
history
<No.>    <author>    <time>      <description>
 1       kenw        20170930    creation
|******************************************************************************/
void CanMain_10msAMainFunction( void )
{
    Ccl_10_0msTaskCont();
}

/*******************************************************************************
Name            :
Syntax            :
Sync/Async        :
Reentrancy        :
Parameters(in)    :
Parameters(out) :
Return value    :
Description        :
Call By            :
history
<No.>    <author>    <time>      <description>
  1      kenw        20170930    creation
|******************************************************************************/
void CanMain_10msBMainFunction( void )
{

	CanDem_MainFunction10ms();
    Random_GetSeedMainFunction();
	
}

/*******************************************************************************
Name            :
Syntax            :
Sync/Async        :
Reentrancy        :
Parameters(in)    :
Parameters(out) :
Return value    :
Description        :
Call By            :
history
<No.>    <author>    <time>      <description>
  1         kenw        20170926    creation
|******************************************************************************/
void CanMain_20msMainFunction(void)
{
	CanDem_MainFunction20ms();
    //CDiagUart_MainFunction();
    if(SeCanMain_u_Start5SFlag == 0u)
    {
        SeCanMain_u_5SCount --;
        if(SeCanMain_u_5SCount == 0u)
        {
            SeCanMain_u_Start5SFlag = 1u;
            if(SeCanMain_u_ResetFlag == 1)
            {
                SystemSoftwareReset();
                
            }
        }
    }
    
}



/*******************************************************************************
| Function name     :
| Called by         :
| Preconditions     :
| Input Parameters  :
| Return Value      :
| Description       :
| <No.>   <author>    <time>      <description>
|  1       kenw       20171026     primary edition.
|******************************************************************************/
uint8 CanMain_GetDTCENFlag(void)
{
    return SeCanMain_u_Start5SFlag;
    
}


void CanMain_SetNeedReset(void)
{
    SeCanMain_u_ResetFlag = 1;
}

uint8 CanMain_GetNeedReset(void)
{
    return SeCanMain_u_ResetFlag;
}

void CanMailboxIsr_01111111111( void )
{

} /* END OF CanMailboxIsr */
/*******************************************************************************
Name            :
Syntax            :
Sync/Async        : Synchronous
Reentrancy        :
Parameters(in)    : None                        :-
Parameters(out) : None                        :-
Return value    : None                        :-
Description        : Receive  Notification
Call By            :
history
<No.>    <author>    <time>    <description>
1
|******************************************************************************/
static void CanMain_IntEnableIRQFunction( void )
{
    INT_SYS_InstallHandler(CAN1_Error_IRQn, &CanMailboxIsr_01111111111, (isr_t *)0);
    INT_SYS_InstallHandler(CAN1_ORed_0_15_MB_IRQn, &CanMailboxIsr_0, (isr_t *)0);
    INT_SYS_InstallHandler(CAN1_ORed_16_31_MB_IRQn, &CanMailboxIsr_0, (isr_t *)0);
    INT_SYS_InstallHandler(CAN1_ORed_IRQn, &CanBusOffIsr_0, (isr_t *)0);
    INT_SYS_EnableIRQ(CAN1_Error_IRQn);
    INT_SYS_EnableIRQ(CAN1_ORed_0_15_MB_IRQn);
    INT_SYS_EnableIRQ(CAN1_ORed_16_31_MB_IRQn);
    INT_SYS_EnableIRQ(CAN1_ORed_IRQn);
}

/*EOF*/
