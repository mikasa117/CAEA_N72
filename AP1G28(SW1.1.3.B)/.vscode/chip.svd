# YTM32B1ME0 register map
Vendor: YTMicro; File version: 1.6
CPU: CM33 r0p4, little endian, MPU, FPU, 2 interrupt priority bits
Registers are 32-bit, read-write, reset 0x0 unless marked. A register's access mark holds for its fields unless they carry their own. Offsets are from the block's base; [hi:lo] are bit positions; {n}, {i} and the like mark numbered series; 'fields as' and 'values as' point back to an identical list.

## CAN0 (part 3 of 4) — FlexCAN module
Base 0x40030000; register names take the prefix CAN0_
0x8D8 RXIMR22 — The RX Individual Mask Registers are used to store the acceptance masks for ID filtering in Rx MBs and the Legacy Rx FIFO. When the Legacy Rx FIFO is disabled (CAN_MCR.RFEN is negated), an individual mask is provided for each available Rx mailbox on a one-to-one correspondence. When the Legacy Rx FIFO is enabled (CAN_MCR.RFEN is asserted), an individual mask is provided for each Legacy Rx FIFO ID Filter Table Element on a one-to-one correspondence depending on the setting of $ ewline$ CAN_CTRL2.RFFN (see \hyperref[legacy-rx-fifo]{"Legacy Rx FIFO"}). CAN_RXIMR0 stores the individual mask associated with either MB0 or ID Filter Table Element 0, CAN_RXIMR1 stores the individual mask associated with either MB1 or ID Filter Table Element 1, and so on. CAN_RXIMRn registers can only be accessed by the CPU when the FlexCAN is in Freeze mode; otherwise, they are blocked by hardware. The CAN_RXIMRn registers are not affected by reset. They are located in RAM and must be explicitly initialized prior to any reception. The CAN_RXIMRn registers are not available if parameter IRMQ_EN is 0.
  [31:0] MI — Each Individual Mask Bit masks the corresponding bit in both the mailbox filter and Legacy Rx FIFO ID Filter Table element in distinct ways. For mailbox filters, see the RXMGMASK register description. For Legacy Rx FIFO ID Filter Table elements, see the RXFGMASK register description. 0b - The corresponding bit in the filter is ``don't care". 1b - The corresponding bit in the filter is checked.
0x8DC RXIMR23 — The RX Individual Mask Registers are used to store the acceptance masks for ID filtering in Rx MBs and the Legacy Rx FIFO. When the Legacy Rx FIFO is disabled (CAN_MCR.RFEN is negated), an individual mask is provided for each available Rx mailbox on a one-to-one correspondence. When the Legacy Rx FIFO is enabled (CAN_MCR.RFEN is asserted), an individual mask is provided for each Legacy Rx FIFO ID Filter Table Element on a one-to-one correspondence depending on the setting of $ ewline$ CAN_CTRL2.RFFN (see \hyperref[legacy-rx-fifo]{"Legacy Rx FIFO"}). CAN_RXIMR0 stores the individual mask associated with either MB0 or ID Filter Table Element 0, CAN_RXIMR1 stores the individual mask associated with either MB1 or ID Filter Table Element 1, and so on. CAN_RXIMRn registers can only be accessed by the CPU when the FlexCAN is in Freeze mode; otherwise, they are blocked by hardware. The CAN_RXIMRn registers are not affected by reset. They are located in RAM and must be explicitly initialized prior to any reception. The CAN_RXIMRn registers are not available if parameter IRMQ_EN is 0.
  fields as RXIMR22
0x8E0 RXIMR24 — The RX Individual Mask Registers are used to store the acceptance masks for ID filtering in Rx MBs and the Legacy Rx FIFO. When the Legacy Rx FIFO is disabled (CAN_MCR.RFEN is negated), an individual mask is provided for each available Rx mailbox on a one-to-one correspondence. When the Legacy Rx FIFO is enabled (CAN_MCR.RFEN is asserted), an individual mask is provided for each Legacy Rx FIFO ID Filter Table Element on a one-to-one correspondence depending on the setting of $ ewline$ CAN_CTRL2.RFFN (see \hyperref[legacy-rx-fifo]{"Legacy Rx FIFO"}). CAN_RXIMR0 stores the individual mask associated with either MB0 or ID Filter Table Element 0, CAN_RXIMR1 stores the individual mask associated with either MB1 or ID Filter Table Element 1, and so on. CAN_RXIMRn registers can only be accessed by the CPU when the FlexCAN is in Freeze mode; otherwise, they are blocked by hardware. The CAN_RXIMRn registers are not affected by reset. They are located in RAM and must be explicitly initialized prior to any reception. The CAN_RXIMRn registers are not available if parameter IRMQ_EN is 0.
  fields as RXIMR22
0x8E4 RXIMR25 — The RX Individual Mask Registers are used to store the acceptance masks for ID filtering in Rx MBs and the Legacy Rx FIFO. When the Legacy Rx FIFO is disabled (CAN_MCR.RFEN is negated), an individual mask is provided for each available Rx mailbox on a one-to-one correspondence. When the Legacy Rx FIFO is enabled (CAN_MCR.RFEN is asserted), an individual mask is provided for each Legacy Rx FIFO ID Filter Table Element on a one-to-one correspondence depending on the setting of $ ewline$ CAN_CTRL2.RFFN (see \hyperref[legacy-rx-fifo]{"Legacy Rx FIFO"}). CAN_RXIMR0 stores the individual mask associated with either MB0 or ID Filter Table Element 0, CAN_RXIMR1 stores the individual mask associated with either MB1 or ID Filter Table Element 1, and so on. CAN_RXIMRn registers can only be accessed by the CPU when the FlexCAN is in Freeze mode; otherwise, they are blocked by hardware. The CAN_RXIMRn registers are not affected by reset. They are located in RAM and must be explicitly initialized prior to any reception. The CAN_RXIMRn registers are not available if parameter IRMQ_EN is 0.
  fields as RXIMR22
0x8E8 RXIMR26 — The RX Individual Mask Registers are used to store the acceptance masks for ID filtering in Rx MBs and the Legacy Rx FIFO. When the Legacy Rx FIFO is disabled (CAN_MCR.RFEN is negated), an individual mask is provided for each available Rx mailbox on a one-to-one correspondence. When the Legacy Rx FIFO is enabled (CAN_MCR.RFEN is asserted), an individual mask is provided for each Legacy Rx FIFO ID Filter Table Element on a one-to-one correspondence depending on the setting of $ ewline$ CAN_CTRL2.RFFN (see \hyperref[legacy-rx-fifo]{"Legacy Rx FIFO"}). CAN_RXIMR0 stores the individual mask associated with either MB0 or ID Filter Table Element 0, CAN_RXIMR1 stores the individual mask associated with either MB1 or ID Filter Table Element 1, and so on. CAN_RXIMRn registers can only be accessed by the CPU when the FlexCAN is in Freeze mode; otherwise, they are blocked by hardware. The CAN_RXIMRn registers are not affected by reset. They are located in RAM and must be explicitly initialized prior to any reception. The CAN_RXIMRn registers are not available if parameter IRMQ_EN is 0.
  fields as RXIMR22
0x8EC RXIMR27 — The RX Individual Mask Registers are used to store the acceptance masks for ID filtering in Rx MBs and the Legacy Rx FIFO. When the Legacy Rx FIFO is disabled (CAN_MCR.RFEN is negated), an individual mask is provided for each available Rx mailbox on a one-to-one correspondence. When the Legacy Rx FIFO is enabled (CAN_MCR.RFEN is asserted), an individual mask is provided for each Legacy Rx FIFO ID Filter Table Element on a one-to-one correspondence depending on the setting of $ ewline$ CAN_CTRL2.RFFN (see \hyperref[legacy-rx-fifo]{"Legacy Rx FIFO"}). CAN_RXIMR0 stores the individual mask associated with either MB0 or ID Filter Table Element 0, CAN_RXIMR1 stores the individual mask associated with either MB1 or ID Filter Table Element 1, and so on. CAN_RXIMRn registers can only be accessed by the CPU when the FlexCAN is in Freeze mode; otherwise, they are blocked by hardware. The CAN_RXIMRn registers are not affected by reset. They are located in RAM and must be explicitly initialized prior to any reception. The CAN_RXIMRn registers are not available if parameter IRMQ_EN is 0.
  fields as RXIMR22
0x8F0 RXIMR28 — The RX Individual Mask Registers are used to store the acceptance masks for ID filtering in Rx MBs and the Legacy Rx FIFO. When the Legacy Rx FIFO is disabled (CAN_MCR.RFEN is negated), an individual mask is provided for each available Rx mailbox on a one-to-one correspondence. When the Legacy Rx FIFO is enabled (CAN_MCR.RFEN is asserted), an individual mask is provided for each Legacy Rx FIFO ID Filter Table Element on a one-to-one correspondence depending on the setting of $ ewline$ CAN_CTRL2.RFFN (see \hyperref[legacy-rx-fifo]{"Legacy Rx FIFO"}). CAN_RXIMR0 stores the individual mask associated with either MB0 or ID Filter Table Element 0, CAN_RXIMR1 stores the individual mask associated with either MB1 or ID Filter Table Element 1, and so on. CAN_RXIMRn registers can only be accessed by the CPU when the FlexCAN is in Freeze mode; otherwise, they are blocked by hardware. The CAN_RXIMRn registers are not affected by reset. They are located in RAM and must be explicitly initialized prior to any reception. The CAN_RXIMRn registers are not available if parameter IRMQ_EN is 0.
  fields as RXIMR22
0x8F4 RXIMR29 — The RX Individual Mask Registers are used to store the acceptance masks for ID filtering in Rx MBs and the Legacy Rx FIFO. When the Legacy Rx FIFO is disabled (CAN_MCR.RFEN is negated), an individual mask is provided for each available Rx mailbox on a one-to-one correspondence. When the Legacy Rx FIFO is enabled (CAN_MCR.RFEN is asserted), an individual mask is provided for each Legacy Rx FIFO ID Filter Table Element on a one-to-one correspondence depending on the setting of $ ewline$ CAN_CTRL2.RFFN (see \hyperref[legacy-rx-fifo]{"Legacy Rx FIFO"}). CAN_RXIMR0 stores the individual mask associated with either MB0 or ID Filter Table Element 0, CAN_RXIMR1 stores the individual mask associated with either MB1 or ID Filter Table Element 1, and so on. CAN_RXIMRn registers can only be accessed by the CPU when the FlexCAN is in Freeze mode; otherwise, they are blocked by hardware. The CAN_RXIMRn registers are not affected by reset. They are located in RAM and must be explicitly initialized prior to any reception. The CAN_RXIMRn registers are not available if parameter IRMQ_EN is 0.
  fields as RXIMR22
0x8F8 RXIMR30 — The RX Individual Mask Registers are used to store the acceptance masks for ID filtering in Rx MBs and the Legacy Rx FIFO. When the Legacy Rx FIFO is disabled (CAN_MCR.RFEN is negated), an individual mask is provided for each available Rx mailbox on a one-to-one correspondence. When the Legacy Rx FIFO is enabled (CAN_MCR.RFEN is asserted), an individual mask is provided for each Legacy Rx FIFO ID Filter Table Element on a one-to-one correspondence depending on the setting of $ ewline$ CAN_CTRL2.RFFN (see \hyperref[legacy-rx-fifo]{"Legacy Rx FIFO"}). CAN_RXIMR0 stores the individual mask associated with either MB0 or ID Filter Table Element 0, CAN_RXIMR1 stores the individual mask associated with either MB1 or ID Filter Table Element 1, and so on. CAN_RXIMRn registers can only be accessed by the CPU when the FlexCAN is in Freeze mode; otherwise, they are blocked by hardware. The CAN_RXIMRn registers are not affected by reset. They are located in RAM and must be explicitly initialized prior to any reception. The CAN_RXIMRn registers are not available if parameter IRMQ_EN is 0.
  fields as RXIMR22
0x8FC RXIMR31 — The RX Individual Mask Registers are used to store the acceptance masks for ID filtering in Rx MBs and the Legacy Rx FIFO. When the Legacy Rx FIFO is disabled (CAN_MCR.RFEN is negated), an individual mask is provided for each available Rx mailbox on a one-to-one correspondence. When the Legacy Rx FIFO is enabled (CAN_MCR.RFEN is asserted), an individual mask is provided for each Legacy Rx FIFO ID Filter Table Element on a one-to-one correspondence depending on the setting of $ ewline$ CAN_CTRL2.RFFN (see \hyperref[legacy-rx-fifo]{"Legacy Rx FIFO"}). CAN_RXIMR0 stores the individual mask associated with either MB0 or ID Filter Table Element 0, CAN_RXIMR1 stores the individual mask associated with either MB1 or ID Filter Table Element 1, and so on. CAN_RXIMRn registers can only be accessed by the CPU when the FlexCAN is in Freeze mode; otherwise, they are blocked by hardware. The CAN_RXIMRn registers are not affected by reset. They are located in RAM and must be explicitly initialized prior to any reception. The CAN_RXIMRn registers are not available if parameter IRMQ_EN is 0.
  fields as RXIMR22
0x900 RXIMR32 — The RX Individual Mask Registers are used to store the acceptance masks for ID filtering in Rx MBs and the Legacy Rx FIFO. When the Legacy Rx FIFO is disabled (CAN_MCR.RFEN is negated), an individual mask is provided for each available Rx mailbox on a one-to-one correspondence. When the Legacy Rx FIFO is enabled (CAN_MCR.RFEN is asserted), an individual mask is provided for each Legacy Rx FIFO ID Filter Table Element on a one-to-one correspondence depending on the setting of $ ewline$ CAN_CTRL2.RFFN (see \hyperref[legacy-rx-fifo]{"Legacy Rx FIFO"}). CAN_RXIMR0 stores the individual mask associated with either MB0 or ID Filter Table Element 0, CAN_RXIMR1 stores the individual mask associated with either MB1 or ID Filter Table Element 1, and so on. CAN_RXIMRn registers can only be accessed by the CPU when the FlexCAN is in Freeze mode; otherwise, they are blocked by hardware. The CAN_RXIMRn registers are not affected by reset. They are located in RAM and must be explicitly initialized prior to any reception. The CAN_RXIMRn registers are not available if parameter IRMQ_EN is 0.
  fields as RXIMR22
0x904 RXIMR33 — The RX Individual Mask Registers are used to store the acceptance masks for ID filtering in Rx MBs and the Legacy Rx FIFO. When the Legacy Rx FIFO is disabled (CAN_MCR.RFEN is negated), an individual mask is provided for each available Rx mailbox on a one-to-one correspondence. When the Legacy Rx FIFO is enabled (CAN_MCR.RFEN is asserted), an individual mask is provided for each Legacy Rx FIFO ID Filter Table Element on a one-to-one correspondence depending on the setting of $ ewline$ CAN_CTRL2.RFFN (see \hyperref[legacy-rx-fifo]{"Legacy Rx FIFO"}). CAN_RXIMR0 stores the individual mask associated with either MB0 or ID Filter Table Element 0, CAN_RXIMR1 stores the individual mask associated with either MB1 or ID Filter Table Element 1, and so on. CAN_RXIMRn registers can only be accessed by the CPU when the FlexCAN is in Freeze mode; otherwise, they are blocked by hardware. The CAN_RXIMRn registers are not affected by reset. They are located in RAM and must be explicitly initialized prior to any reception. The CAN_RXIMRn registers are not available if parameter IRMQ_EN is 0.
  fields as RXIMR22
0x908 RXIMR34 — The RX Individual Mask Registers are used to store the acceptance masks for ID filtering in Rx MBs and the Legacy Rx FIFO. When the Legacy Rx FIFO is disabled (CAN_MCR.RFEN is negated), an individual mask is provided for each available Rx mailbox on a one-to-one correspondence. When the Legacy Rx FIFO is enabled (CAN_MCR.RFEN is asserted), an individual mask is provided for each Legacy Rx FIFO ID Filter Table Element on a one-to-one correspondence depending on the setting of $ ewline$ CAN_CTRL2.RFFN (see \hyperref[legacy-rx-fifo]{"Legacy Rx FIFO"}). CAN_RXIMR0 stores the individual mask associated with either MB0 or ID Filter Table Element 0, CAN_RXIMR1 stores the individual mask associated with either MB1 or ID Filter Table Element 1, and so on. CAN_RXIMRn registers can only be accessed by the CPU when the FlexCAN is in Freeze mode; otherwise, they are blocked by hardware. The CAN_RXIMRn registers are not affected by reset. They are located in RAM and must be explicitly initialized prior to any reception. The CAN_RXIMRn registers are not available if parameter IRMQ_EN is 0.
  fields as RXIMR22
0x90C RXIMR35 — The RX Individual Mask Registers are used to store the acceptance masks for ID filtering in Rx MBs and the Legacy Rx FIFO. When the Legacy Rx FIFO is disabled (CAN_MCR.RFEN is negated), an individual mask is provided for each available Rx mailbox on a one-to-one correspondence. When the Legacy Rx FIFO is enabled (CAN_MCR.RFEN is asserted), an individual mask is provided for each Legacy Rx FIFO ID Filter Table Element on a one-to-one correspondence depending on the setting of $ ewline$ CAN_CTRL2.RFFN (see \hyperref[legacy-rx-fifo]{"Legacy Rx FIFO"}). CAN_RXIMR0 stores the individual mask associated with either MB0 or ID Filter Table Element 0, CAN_RXIMR1 stores the individual mask associated with either MB1 or ID Filter Table Element 1, and so on. CAN_RXIMRn registers can only be accessed by the CPU when the FlexCAN is in Freeze mode; otherwise, they are blocked by hardware. The CAN_RXIMRn registers are not affected by reset. They are located in RAM and must be explicitly initialized prior to any reception. The CAN_RXIMRn registers are not available if parameter IRMQ_EN is 0.
  fields as RXIMR22
0x910 RXIMR36 — The RX Individual Mask Registers are used to store the acceptance masks for ID filtering in Rx MBs and the Legacy Rx FIFO. When the Legacy Rx FIFO is disabled (CAN_MCR.RFEN is negated), an individual mask is provided for each available Rx mailbox on a one-to-one correspondence. When the Legacy Rx FIFO is enabled (CAN_MCR.RFEN is asserted), an individual mask is provided for each Legacy Rx FIFO ID Filter Table Element on a one-to-one correspondence depending on the setting of $ ewline$ CAN_CTRL2.RFFN (see \hyperref[legacy-rx-fifo]{"Legacy Rx FIFO"}). CAN_RXIMR0 stores the individual mask associated with either MB0 or ID Filter Table Element 0, CAN_RXIMR1 stores the individual mask associated with either MB1 or ID Filter Table Element 1, and so on. CAN_RXIMRn registers can only be accessed by the CPU when the FlexCAN is in Freeze mode; otherwise, they are blocked by hardware. The CAN_RXIMRn registers are not affected by reset. They are located in RAM and must be explicitly initialized prior to any reception. The CAN_RXIMRn registers are not available if parameter IRMQ_EN is 0.
  fields as RXIMR22
0x914 RXIMR37 — The RX Individual Mask Registers are used to store the acceptance masks for ID filtering in Rx MBs and the Legacy Rx FIFO. When the Legacy Rx FIFO is disabled (CAN_MCR.RFEN is negated), an individual mask is provided for each available Rx mailbox on a one-to-one correspondence. When the Legacy Rx FIFO is enabled (CAN_MCR.RFEN is asserted), an individual mask is provided for each Legacy Rx FIFO ID Filter Table Element on a one-to-one correspondence depending on the setting of $ ewline$ CAN_CTRL2.RFFN (see \hyperref[legacy-rx-fifo]{"Legacy Rx FIFO"}). CAN_RXIMR0 stores the individual mask associated with either MB0 or ID Filter Table Element 0, CAN_RXIMR1 stores the individual mask associated with either MB1 or ID Filter Table Element 1, and so on. CAN_RXIMRn registers can only be accessed by the CPU when the FlexCAN is in Freeze mode; otherwise, they are blocked by hardware. The CAN_RXIMRn registers are not affected by reset. They are located in RAM and must be explicitly initialized prior to any reception. The CAN_RXIMRn registers are not available if parameter IRMQ_EN is 0.
  fields as RXIMR22
0x918 RXIMR38 — The RX Individual Mask Registers are used to store the acceptance masks for ID filtering in Rx MBs and the Legacy Rx FIFO. When the Legacy Rx FIFO is disabled (CAN_MCR.RFEN is negated), an individual mask is provided for each available Rx mailbox on a one-to-one correspondence. When the Legacy Rx FIFO is enabled (CAN_MCR.RFEN is asserted), an individual mask is provided for each Legacy Rx FIFO ID Filter Table Element on a one-to-one correspondence depending on the setting of $ ewline$ CAN_CTRL2.RFFN (see \hyperref[legacy-rx-fifo]{"Legacy Rx FIFO"}). CAN_RXIMR0 stores the individual mask associated with either MB0 or ID Filter Table Element 0, CAN_RXIMR1 stores the individual mask associated with either MB1 or ID Filter Table Element 1, and so on. CAN_RXIMRn registers can only be accessed by the CPU when the FlexCAN is in Freeze mode; otherwise, they are blocked by hardware. The CAN_RXIMRn registers are not affected by reset. They are located in RAM and must be explicitly initialized prior to any reception. The CAN_RXIMRn registers are not available if parameter IRMQ_EN is 0.
  fields as RXIMR22
0x91C RXIMR39 — The RX Individual Mask Registers are used to store the acceptance masks for ID filtering in Rx MBs and the Legacy Rx FIFO. When the Legacy Rx FIFO is disabled (CAN_MCR.RFEN is negated), an individual mask is provided for each available Rx mailbox on a one-to-one correspondence. When the Legacy Rx FIFO is enabled (CAN_MCR.RFEN is asserted), an individual mask is provided for each Legacy Rx FIFO ID Filter Table Element on a one-to-one correspondence depending on the setting of $ ewline$ CAN_CTRL2.RFFN (see \hyperref[legacy-rx-fifo]{"Legacy Rx FIFO"}). CAN_RXIMR0 stores the individual mask associated with either MB0 or ID Filter Table Element 0, CAN_RXIMR1 stores the individual mask associated with either MB1 or ID Filter Table Element 1, and so on. CAN_RXIMRn registers can only be accessed by the CPU when the FlexCAN is in Freeze mode; otherwise, they are blocked by hardware. The CAN_RXIMRn registers are not affected by reset. They are located in RAM and must be explicitly initialized prior to any reception. The CAN_RXIMRn registers are not available if parameter IRMQ_EN is 0.
  fields as RXIMR22
0x920 RXIMR40 — The RX Individual Mask Registers are used to store the acceptance masks for ID filtering in Rx MBs and the Legacy Rx FIFO. When the Legacy Rx FIFO is disabled (CAN_MCR.RFEN is negated), an individual mask is provided for each available Rx mailbox on a one-to-one correspondence. When the Legacy Rx FIFO is enabled (CAN_MCR.RFEN is asserted), an individual mask is provided for each Legacy Rx FIFO ID Filter Table Element on a one-to-one correspondence depending on the setting of $ ewline$ CAN_CTRL2.RFFN (see \hyperref[legacy-rx-fifo]{"Legacy Rx FIFO"}). CAN_RXIMR0 stores the individual mask associated with either MB0 or ID Filter Table Element 0, CAN_RXIMR1 stores the individual mask associated with either MB1 or ID Filter Table Element 1, and so on. CAN_RXIMRn registers can only be accessed by the CPU when the FlexCAN is in Freeze mode; otherwise, they are blocked by hardware. The CAN_RXIMRn registers are not affected by reset. They are located in RAM and must be explicitly initialized prior to any reception. The CAN_RXIMRn registers are not available if parameter IRMQ_EN is 0.
  fields as RXIMR22
0x924 RXIMR41 — The RX Individual Mask Registers are used to store the acceptance masks for ID filtering in Rx MBs and the Legacy Rx FIFO. When the Legacy Rx FIFO is disabled (CAN_MCR.RFEN is negated), an individual mask is provided for each available Rx mailbox on a one-to-one correspondence. When the Legacy Rx FIFO is enabled (CAN_MCR.RFEN is asserted), an individual mask is provided for each Legacy Rx FIFO ID Filter Table Element on a one-to-one correspondence depending on the setting of $ ewline$ CAN_CTRL2.RFFN (see \hyperref[legacy-rx-fifo]{"Legacy Rx FIFO"}). CAN_RXIMR0 stores the individual mask associated with either MB0 or ID Filter Table Element 0, CAN_RXIMR1 stores the individual mask associated with either MB1 or ID Filter Table Element 1, and so on. CAN_RXIMRn registers can only be accessed by the CPU when the FlexCAN is in Freeze mode; otherwise, they are blocked by hardware. The CAN_RXIMRn registers are not affected by reset. They are located in RAM and must be explicitly initialized prior to any reception. The CAN_RXIMRn registers are not available if parameter IRMQ_EN is 0.
  fields as RXIMR22
0x928 RXIMR42 — The RX Individual Mask Registers are used to store the acceptance masks for ID filtering in Rx MBs and the Legacy Rx FIFO. When the Legacy Rx FIFO is disabled (CAN_MCR.RFEN is negated), an individual mask is provided for each available Rx mailbox on a one-to-one correspondence. When the Legacy Rx FIFO is enabled (CAN_MCR.RFEN is asserted), an individual mask is provided for each Legacy Rx FIFO ID Filter Table Element on a one-to-one correspondence depending on the setting of $ ewline$ CAN_CTRL2.RFFN (see \hyperref[legacy-rx-fifo]{"Legacy Rx FIFO"}). CAN_RXIMR0 stores the individual mask associated with either MB0 or ID Filter Table Element 0, CAN_RXIMR1 stores the individual mask associated with either MB1 or ID Filter Table Element 1, and so on. CAN_RXIMRn registers can only be accessed by the CPU when the FlexCAN is in Freeze mode; otherwise, they are blocked by hardware. The CAN_RXIMRn registers are not affected by reset. They are located in RAM and must be explicitly initialized prior to any reception. The CAN_RXIMRn registers are not available if parameter IRMQ_EN is 0.
  fields as RXIMR22
0x92C RXIMR43 — The RX Individual Mask Registers are used to store the acceptance masks for ID filtering in Rx MBs and the Legacy Rx FIFO. When the Legacy Rx FIFO is disabled (CAN_MCR.RFEN is negated), an individual mask is provided for each available Rx mailbox on a one-to-one correspondence. When the Legacy Rx FIFO is enabled (CAN_MCR.RFEN is asserted), an individual mask is provided for each Legacy Rx FIFO ID Filter Table Element on a one-to-one correspondence depending on the setting of $ ewline$ CAN_CTRL2.RFFN (see \hyperref[legacy-rx-fifo]{"Legacy Rx FIFO"}). CAN_RXIMR0 stores the individual mask associated with either MB0 or ID Filter Table Element 0, CAN_RXIMR1 stores the individual mask associated with either MB1 or ID Filter Table Element 1, and so on. CAN_RXIMRn registers can only be accessed by the CPU when the FlexCAN is in Freeze mode; otherwise, they are blocked by hardware. The CAN_RXIMRn registers are not affected by reset. They are located in RAM and must be explicitly initialized prior to any reception. The CAN_RXIMRn registers are not available if parameter IRMQ_EN is 0.
  fields as RXIMR22
0x930 RXIMR44 — The RX Individual Mask Registers are used to store the acceptance masks for ID filtering in Rx MBs and the Legacy Rx FIFO. When the Legacy Rx FIFO is disabled (CAN_MCR.RFEN is negated), an individual mask is provided for each available Rx mailbox on a one-to-one correspondence. When the Legacy Rx FIFO is enabled (CAN_MCR.RFEN is asserted), an individual mask is provided for each Legacy Rx FIFO ID Filter Table Element on a one-to-one correspondence depending on the setting of $ ewline$ CAN_CTRL2.RFFN (see \hyperref[legacy-rx-fifo]{"Legacy Rx FIFO"}). CAN_RXIMR0 stores the individual mask associated with either MB0 or ID Filter Table Element 0, CAN_RXIMR1 stores the individual mask associated with either MB1 or ID Filter Table Element 1, and so on. CAN_RXIMRn registers can only be accessed by the CPU when the FlexCAN is in Freeze mode; otherwise, they are blocked by hardware. The CAN_RXIMRn registers are not affected by reset. They are located in RAM and must be explicitly initialized prior to any reception. The CAN_RXIMRn registers are not available if parameter IRMQ_EN is 0.
  fields as RXIMR22
0x934 RXIMR45 — The RX Individual Mask Registers are used to store the acceptance masks for ID filtering in Rx MBs and the Legacy Rx FIFO. When the Legacy Rx FIFO is disabled (CAN_MCR.RFEN is negated), an individual mask is provided for each available Rx mailbox on a one-to-one correspondence. When the Legacy Rx FIFO is enabled (CAN_MCR.RFEN is asserted), an individual mask is provided for each Legacy Rx FIFO ID Filter Table Element on a one-to-one correspondence depending on the setting of $ ewline$ CAN_CTRL2.RFFN (see \hyperref[legacy-rx-fifo]{"Legacy Rx FIFO"}). CAN_RXIMR0 stores the individual mask associated with either MB0 or ID Filter Table Element 0, CAN_RXIMR1 stores the individual mask associated with either MB1 or ID Filter Table Element 1, and so on. CAN_RXIMRn registers can only be accessed by the CPU when the FlexCAN is in Freeze mode; otherwise, they are blocked by hardware. The CAN_RXIMRn registers are not affected by reset. They are located in RAM and must be explicitly initialized prior to any reception. The CAN_RXIMRn registers are not available if parameter IRMQ_EN is 0.
  fields as RXIMR22
0x938 RXIMR46 — The RX Individual Mask Registers are used to store the acceptance masks for ID filtering in Rx MBs and the Legacy Rx FIFO. When the Legacy Rx FIFO is disabled (CAN_MCR.RFEN is negated), an individual mask is provided for each available Rx mailbox on a one-to-one correspondence. When the Legacy Rx FIFO is enabled (CAN_MCR.RFEN is asserted), an individual mask is provided for each Legacy Rx FIFO ID Filter Table Element on a one-to-one correspondence depending on the setting of $ ewline$ CAN_CTRL2.RFFN (see \hyperref[legacy-rx-fifo]{"Legacy Rx FIFO"}). CAN_RXIMR0 stores the individual mask associated with either MB0 or ID Filter Table Element 0, CAN_RXIMR1 stores the individual mask associated with either MB1 or ID Filter Table Element 1, and so on. CAN_RXIMRn registers can only be accessed by the CPU when the FlexCAN is in Freeze mode; otherwise, they are blocked by hardware. The CAN_RXIMRn registers are not affected by reset. They are located in RAM and must be explicitly initialized prior to any reception. The CAN_RXIMRn registers are not available if parameter IRMQ_EN is 0.
  fields as RXIMR22
0x93C RXIMR47 — The RX Individual Mask Registers are used to store the acceptance masks for ID filtering in Rx MBs and the Legacy Rx FIFO. When the Legacy Rx FIFO is disabled (CAN_MCR.RFEN is negated), an individual mask is provided for each available Rx mailbox on a one-to-one correspondence. When the Legacy Rx FIFO is enabled (CAN_MCR.RFEN is asserted), an individual mask is provided for each Legacy Rx FIFO ID Filter Table Element on a one-to-one correspondence depending on the setting of $ ewline$ CAN_CTRL2.RFFN (see \hyperref[legacy-rx-fifo]{"Legacy Rx FIFO"}). CAN_RXIMR0 stores the individual mask associated with either MB0 or ID Filter Table Element 0, CAN_RXIMR1 stores the individual mask associated with either MB1 or ID Filter Table Element 1, and so on. CAN_RXIMRn registers can only be accessed by the CPU when the FlexCAN is in Freeze mode; otherwise, they are blocked by hardware. The CAN_RXIMRn registers are not affected by reset. They are located in RAM and must be explicitly initialized prior to any reception. The CAN_RXIMRn registers are not available if parameter IRMQ_EN is 0.
  fields as RXIMR22
0x940 RXIMR48 — The RX Individual Mask Registers are used to store the acceptance masks for ID filtering in Rx MBs and the Legacy Rx FIFO. When the Legacy Rx FIFO is disabled (CAN_MCR.RFEN is negated), an individual mask is provided for each available Rx mailbox on a one-to-one correspondence. When the Legacy Rx FIFO is enabled (CAN_MCR.RFEN is asserted), an individual mask is provided for each Legacy Rx FIFO ID Filter Table Element on a one-to-one correspondence depending on the setting of $ ewline$ CAN_CTRL2.RFFN (see \hyperref[legacy-rx-fifo]{"Legacy Rx FIFO"}). CAN_RXIMR0 stores the individual mask associated with either MB0 or ID Filter Table Element 0, CAN_RXIMR1 stores the individual mask associated with either MB1 or ID Filter Table Element 1, and so on. CAN_RXIMRn registers can only be accessed by the CPU when the FlexCAN is in Freeze mode; otherwise, they are blocked by hardware. The CAN_RXIMRn registers are not affected by reset. They are located in RAM and must be explicitly initialized prior to any reception. The CAN_RXIMRn registers are not available if parameter IRMQ_EN is 0.
  fields as RXIMR22
0x944 RXIMR49 — The RX Individual Mask Registers are used to store the acceptance masks for ID filtering in Rx MBs and the Legacy Rx FIFO. When the Legacy Rx FIFO is disabled (CAN_MCR.RFEN is negated), an individual mask is provided for each available Rx mailbox on a one-to-one correspondence. When the Legacy Rx FIFO is enabled (CAN_MCR.RFEN is asserted), an individual mask is provided for each Legacy Rx FIFO ID Filter Table Element on a one-to-one correspondence depending on the setting of $ ewline$ CAN_CTRL2.RFFN (see \hyperref[legacy-rx-fifo]{"Legacy Rx FIFO"}). CAN_RXIMR0 stores the individual mask associated with either MB0 or ID Filter Table Element 0, CAN_RXIMR1 stores the individual mask associated with either MB1 or ID Filter Table Element 1, and so on. CAN_RXIMRn registers can only be accessed by the CPU when the FlexCAN is in Freeze mode; otherwise, they are blocked by hardware. The CAN_RXIMRn registers are not affected by reset. They are located in RAM and must be explicitly initialized prior to any reception. The CAN_RXIMRn registers are not available if parameter IRMQ_EN is 0.
  fields as RXIMR22
0x948 RXIMR50 — The RX Individual Mask Registers are used to store the acceptance masks for ID filtering in Rx MBs and the Legacy Rx FIFO. When the Legacy Rx FIFO is disabled (CAN_MCR.RFEN is negated), an individual mask is provided for each available Rx mailbox on a one-to-one correspondence. When the Legacy Rx FIFO is enabled (CAN_MCR.RFEN is asserted), an individual mask is provided for each Legacy Rx FIFO ID Filter Table Element on a one-to-one correspondence depending on the setting of $ ewline$ CAN_CTRL2.RFFN (see \hyperref[legacy-rx-fifo]{"Legacy Rx FIFO"}). CAN_RXIMR0 stores the individual mask associated with either MB0 or ID Filter Table Element 0, CAN_RXIMR1 stores the individual mask associated with either MB1 or ID Filter Table Element 1, and so on. CAN_RXIMRn registers can only be accessed by the CPU when the FlexCAN is in Freeze mode; otherwise, they are blocked by hardware. The CAN_RXIMRn registers are not affected by reset. They are located in RAM and must be explicitly initialized prior to any reception. The CAN_RXIMRn registers are not available if parameter IRMQ_EN is 0.
  fields as RXIMR22
0x94C RXIMR51 — The RX Individual Mask Registers are used to store the acceptance masks for ID filtering in Rx MBs and the Legacy Rx FIFO. When the Legacy Rx FIFO is disabled (CAN_MCR.RFEN is negated), an individual mask is provided for each available Rx mailbox on a one-to-one correspondence. When the Legacy Rx FIFO is enabled (CAN_MCR.RFEN is asserted), an individual mask is provided for each Legacy Rx FIFO ID Filter Table Element on a one-to-one correspondence depending on the setting of $ ewline$ CAN_CTRL2.RFFN (see \hyperref[legacy-rx-fifo]{"Legacy Rx FIFO"}). CAN_RXIMR0 stores the individual mask associated with either MB0 or ID Filter Table Element 0, CAN_RXIMR1 stores the individual mask associated with either MB1 or ID Filter Table Element 1, and so on. CAN_RXIMRn registers can only be accessed by the CPU when the FlexCAN is in Freeze mode; otherwise, they are blocked by hardware. The CAN_RXIMRn registers are not affected by reset. They are located in RAM and must be explicitly initialized prior to any reception. The CAN_RXIMRn registers are not available if parameter IRMQ_EN is 0.
  fields as RXIMR22
0x950 RXIMR52 — The RX Individual Mask Registers are used to store the acceptance masks for ID filtering in Rx MBs and the Legacy Rx FIFO. When the Legacy Rx FIFO is disabled (CAN_MCR.RFEN is negated), an individual mask is provided for each available Rx mailbox on a one-to-one correspondence. When the Legacy Rx FIFO is enabled (CAN_MCR.RFEN is asserted), an individual mask is provided for each Legacy Rx FIFO ID Filter Table Element on a one-to-one correspondence depending on the setting of $ ewline$ CAN_CTRL2.RFFN (see \hyperref[legacy-rx-fifo]{"Legacy Rx FIFO"}). CAN_RXIMR0 stores the individual mask associated with either MB0 or ID Filter Table Element 0, CAN_RXIMR1 stores the individual mask associated with either MB1 or ID Filter Table Element 1, and so on. CAN_RXIMRn registers can only be accessed by the CPU when the FlexCAN is in Freeze mode; otherwise, they are blocked by hardware. The CAN_RXIMRn registers are not affected by reset. They are located in RAM and must be explicitly initialized prior to any reception. The CAN_RXIMRn registers are not available if parameter IRMQ_EN is 0.
  fields as RXIMR22
0x954 RXIMR53 — The RX Individual Mask Registers are used to store the acceptance masks for ID filtering in Rx MBs and the Legacy Rx FIFO. When the Legacy Rx FIFO is disabled (CAN_MCR.RFEN is negated), an individual mask is provided for each available Rx mailbox on a one-to-one correspondence. When the Legacy Rx FIFO is enabled (CAN_MCR.RFEN is asserted), an individual mask is provided for each Legacy Rx FIFO ID Filter Table Element on a one-to-one correspondence depending on the setting of $ ewline$ CAN_CTRL2.RFFN (see \hyperref[legacy-rx-fifo]{"Legacy Rx FIFO"}). CAN_RXIMR0 stores the individual mask associated with either MB0 or ID Filter Table Element 0, CAN_RXIMR1 stores the individual mask associated with either MB1 or ID Filter Table Element 1, and so on. CAN_RXIMRn registers can only be accessed by the CPU when the FlexCAN is in Freeze mode; otherwise, they are blocked by hardware. The CAN_RXIMRn registers are not affected by reset. They are located in RAM and must be explicitly initialized prior to any reception. The CAN_RXIMRn registers are not available if parameter IRMQ_EN is 0.
  fields as RXIMR22
0x958 RXIMR54 — The RX Individual Mask Registers are used to store the acceptance masks for ID filtering in Rx MBs and the Legacy Rx FIFO. When the Legacy Rx FIFO is disabled (CAN_MCR.RFEN is negated), an individual mask is provided for each available Rx mailbox on a one-to-one correspondence. When the Legacy Rx FIFO is enabled (CAN_MCR.RFEN is asserted), an individual mask is provided for each Legacy Rx FIFO ID Filter Table Element on a one-to-one correspondence depending on the setting of $ ewline$ CAN_CTRL2.RFFN (see \hyperref[legacy-rx-fifo]{"Legacy Rx FIFO"}). CAN_RXIMR0 stores the individual mask associated with either MB0 or ID Filter Table Element 0, CAN_RXIMR1 stores the individual mask associated with either MB1 or ID Filter Table Element 1, and so on. CAN_RXIMRn registers can only be accessed by the CPU when the FlexCAN is in Freeze mode; otherwise, they are blocked by hardware. The CAN_RXIMRn registers are not affected by reset. They are located in RAM and must be explicitly initialized prior to any reception. The CAN_RXIMRn registers are not available if parameter IRMQ_EN is 0.
  fields as RXIMR22
0x95C RXIMR55 — The RX Individual Mask Registers are used to store the acceptance masks for ID filtering in Rx MBs and the Legacy Rx FIFO. When the Legacy Rx FIFO is disabled (CAN_MCR.RFEN is negated), an individual mask is provided for each available Rx mailbox on a one-to-one correspondence. When the Legacy Rx FIFO is enabled (CAN_MCR.RFEN is asserted), an individual mask is provided for each Legacy Rx FIFO ID Filter Table Element on a one-to-one correspondence depending on the setting of $ ewline$ CAN_CTRL2.RFFN (see \hyperref[legacy-rx-fifo]{"Legacy Rx FIFO"}). CAN_RXIMR0 stores the individual mask associated with either MB0 or ID Filter Table Element 0, CAN_RXIMR1 stores the individual mask associated with either MB1 or ID Filter Table Element 1, and so on. CAN_RXIMRn registers can only be accessed by the CPU when the FlexCAN is in Freeze mode; otherwise, they are blocked by hardware. The CAN_RXIMRn registers are not affected by reset. They are located in RAM and must be explicitly initialized prior to any reception. The CAN_RXIMRn registers are not available if parameter IRMQ_EN is 0.
  fields as RXIMR22
0x960 RXIMR56 — The RX Individual Mask Registers are used to store the acceptance masks for ID filtering in Rx MBs and the Legacy Rx FIFO. When the Legacy Rx FIFO is disabled (CAN_MCR.RFEN is negated), an individual mask is provided for each available Rx mailbox on a one-to-one correspondence. When the Legacy Rx FIFO is enabled (CAN_MCR.RFEN is asserted), an individual mask is provided for each Legacy Rx FIFO ID Filter Table Element on a one-to-one correspondence depending on the setting of $ ewline$ CAN_CTRL2.RFFN (see \hyperref[legacy-rx-fifo]{"Legacy Rx FIFO"}). CAN_RXIMR0 stores the individual mask associated with either MB0 or ID Filter Table Element 0, CAN_RXIMR1 stores the individual mask associated with either MB1 or ID Filter Table Element 1, and so on. CAN_RXIMRn registers can only be accessed by the CPU when the FlexCAN is in Freeze mode; otherwise, they are blocked by hardware. The CAN_RXIMRn registers are not affected by reset. They are located in RAM and must be explicitly initialized prior to any reception. The CAN_RXIMRn registers are not available if parameter IRMQ_EN is 0.
  fields as RXIMR22
0x964 RXIMR57 — The RX Individual Mask Registers are used to store the acceptance masks for ID filtering in Rx MBs and the Legacy Rx FIFO. When the Legacy Rx FIFO is disabled (CAN_MCR.RFEN is negated), an individual mask is provided for each available Rx mailbox on a one-to-one correspondence. When the Legacy Rx FIFO is enabled (CAN_MCR.RFEN is asserted), an individual mask is provided for each Legacy Rx FIFO ID Filter Table Element on a one-to-one correspondence depending on the setting of $ ewline$ CAN_CTRL2.RFFN (see \hyperref[legacy-rx-fifo]{"Legacy Rx FIFO"}). CAN_RXIMR0 stores the individual mask associated with either MB0 or ID Filter Table Element 0, CAN_RXIMR1 stores the individual mask associated with either MB1 or ID Filter Table Element 1, and so on. CAN_RXIMRn registers can only be accessed by the CPU when the FlexCAN is in Freeze mode; otherwise, they are blocked by hardware. The CAN_RXIMRn registers are not affected by reset. They are located in RAM and must be explicitly initialized prior to any reception. The CAN_RXIMRn registers are not available if parameter IRMQ_EN is 0.
  fields as RXIMR22
0x968 RXIMR58 — The RX Individual Mask Registers are used to store the acceptance masks for ID filtering in Rx MBs and the Legacy Rx FIFO. When the Legacy Rx FIFO is disabled (CAN_MCR.RFEN is negated), an individual mask is provided for each available Rx mailbox on a one-to-one correspondence. When the Legacy Rx FIFO is enabled (CAN_MCR.RFEN is asserted), an individual mask is provided for each Legacy Rx FIFO ID Filter Table Element on a one-to-one correspondence depending on the setting of $ ewline$ CAN_CTRL2.RFFN (see \hyperref[legacy-rx-fifo]{"Legacy Rx FIFO"}). CAN_RXIMR0 stores the individual mask associated with either MB0 or ID Filter Table Element 0, CAN_RXIMR1 stores the individual mask associated with either MB1 or ID Filter Table Element 1, and so on. CAN_RXIMRn registers can only be accessed by the CPU when the FlexCAN is in Freeze mode; otherwise, they are blocked by hardware. The CAN_RXIMRn registers are not affected by reset. They are located in RAM and must be explicitly initialized prior to any reception. The CAN_RXIMRn registers are not available if parameter IRMQ_EN is 0.
  fields as RXIMR22
0x96C RXIMR59 — The RX Individual Mask Registers are used to store the acceptance masks for ID filtering in Rx MBs and the Legacy Rx FIFO. When the Legacy Rx FIFO is disabled (CAN_MCR.RFEN is negated), an individual mask is provided for each available Rx mailbox on a one-to-one correspondence. When the Legacy Rx FIFO is enabled (CAN_MCR.RFEN is asserted), an individual mask is provided for each Legacy Rx FIFO ID Filter Table Element on a one-to-one correspondence depending on the setting of $ ewline$ CAN_CTRL2.RFFN (see \hyperref[legacy-rx-fifo]{"Legacy Rx FIFO"}). CAN_RXIMR0 stores the individual mask associated with either MB0 or ID Filter Table Element 0, CAN_RXIMR1 stores the individual mask associated with either MB1 or ID Filter Table Element 1, and so on. CAN_RXIMRn registers can only be accessed by the CPU when the FlexCAN is in Freeze mode; otherwise, they are blocked by hardware. The CAN_RXIMRn registers are not affected by reset. They are located in RAM and must be explicitly initialized prior to any reception. The CAN_RXIMRn registers are not available if parameter IRMQ_EN is 0.
  fields as RXIMR22
0x970 RXIMR60 — The RX Individual Mask Registers are used to store the acceptance masks for ID filtering in Rx MBs and the Legacy Rx FIFO. When the Legacy Rx FIFO is disabled (CAN_MCR.RFEN is negated), an individual mask is provided for each available Rx mailbox on a one-to-one correspondence. When the Legacy Rx FIFO is enabled (CAN_MCR.RFEN is asserted), an individual mask is provided for each Legacy Rx FIFO ID Filter Table Element on a one-to-one correspondence depending on the setting of $ ewline$ CAN_CTRL2.RFFN (see \hyperref[legacy-rx-fifo]{"Legacy Rx FIFO"}). CAN_RXIMR0 stores the individual mask associated with either MB0 or ID Filter Table Element 0, CAN_RXIMR1 stores the individual mask associated with either MB1 or ID Filter Table Element 1, and so on. CAN_RXIMRn registers can only be accessed by the CPU when the FlexCAN is in Freeze mode; otherwise, they are blocked by hardware. The CAN_RXIMRn registers are not affected by reset. They are located in RAM and must be explicitly initialized prior to any reception. The CAN_RXIMRn registers are not available if parameter IRMQ_EN is 0.
  fields as RXIMR22

## CAN1 (part 3 of 4) — FlexCAN module
Base 0x40034000; register names take the prefix CAN1_
Registers as CAN0.

## CAN2 (part 3 of 4) — FlexCAN module
Base 0x40038000; register names take the prefix CAN2_
Registers as CAN0.

## CAN3 (part 3 of 4) — FlexCAN module
Base 0x4003C000; register names take the prefix CAN3_
Registers as CAN0.

## CAN4 (part 3 of 4) — FlexCAN module
Base 0x4003D000; register names take the prefix CAN4_
Registers as CAN0.

## CAN5 (part 3 of 4) — FlexCAN module
Base 0x4003E000; register names take the prefix CAN5_
Registers as CAN0.
